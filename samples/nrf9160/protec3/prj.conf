## sample.yaml
```
sample:
  name: Button Sample
tests:
  sample.basic.button:
    platform_allow: protec3_nrf9160_ns
    platform_whitelist: protec3_nrf9160_ns
    integration_platforms:
      - protec3_nrf9160_ns
    tags: button gpio
    filter: dt_compat_enabled_with_alias("gpio-keys", "sw0")
    depends_on: gpio
    harness: button
```

## prj.conf
```kconfig
#
# Copyright (c) 2020 Nordic Semiconductor ASA
#
# SPDX-License-Identifier: LicenseRef-Nordic-5-Clause
#
# General config
CONFIG_LOG=y
CONFIG_LOG_DEFAULT_LEVEL=3
CONFIG_STACK_SENTINEL=y
CONFIG_NEWLIB_LIBC=y
CONFIG_NEWLIB_LIBC_FLOAT_PRINTF=y
CONFIG_RING_BUFFER=y

# Segger RTT
CONFIG_USE_SEGGER_RTT=y
CONFIG_RTT_CONSOLE=y
CONFIG_UART_CONSOLE=y
CONFIG_LOG_BACKEND_RTT=y
CONFIG_LOG_BACKEND_UART=n

# Network
CONFIG_NETWORKING=y
CONFIG_NET_SOCKETS=y
CONFIG_NET_NATIVE=n

# Modem library
CONFIG_NRF_MODEM_LIB=y
# Align the max FD entry to NRF_MODEM_MAX_SOCKET_COUNT(8)
CONFIG_POSIX_MAX_FDS=8
# Enable below for modem trace
#CONFIG_NRF_MODEM_LIB_TRACE=y
# Handle modem fault
CONFIG_NRF_MODEM_LIB_ON_FAULT_APPLICATION_SPECIFIC=y

# Use GPIO
CONFIG_GPIO=y
CONFIG_GPIO_NRFX=y

# UART interface
CONFIG_SERIAL=y
CONFIG_UART_ASYNC_API=y
CONFIG_NRFX_TIMER2=y

# Stacks and heaps
CONFIG_MAIN_STACK_SIZE=8192
CONFIG_HEAP_MEM_POOL_SIZE=16384
CONFIG_SYSTEM_WORKQUEUE_STACK_SIZE=4096
CONFIG_AT_MONITOR_HEAP_SIZE=4096

# Device power management
CONFIG_PM_DEVICE=y

# FOTA
CONFIG_HTTP_PARSER_URL=y
CONFIG_FOTA_DOWNLOAD=y
CONFIG_FOTA_DOWNLOAD_PROGRESS_EVT=y
CONFIG_DFU_TARGET=y
CONFIG_DOWNLOAD_CLIENT=y
CONFIG_DOWNLOAD_CLIENT_STACK_SIZE=4096
CONFIG_BOOTLOADER_MCUBOOT=y
CONFIG_IMG_MANAGER=y

# FLASH
CONFIG_FLASH=y
CONFIG_FLASH_PAGE_LAYOUT=y
CONFIG_FLASH_MAP=y
CONFIG_STREAM_FLASH=y
CONFIG_MPU_ALLOW_FLASH_WRITE=y
CONFIG_IMG_ERASE_PROGRESSIVELY=y

# Settings
CONFIG_SETTINGS=y
CONFIG_SETTINGS_FCB=y
CONFIG_FCB=y

# nRF Cloud
#CONFIG_NRF_CLOUD_IPV6=y
CONFIG_NRF_CLOUD_MQTT=y
CONFIG_NRF_CLOUD_FOTA=n
CONFIG_NRF_CLOUD_AGPS=y
CONFIG_NRF_CLOUD_AGPS_FILTERED=n
CONFIG_NRF_CLOUD_PGPS=y
CONFIG_NRF_CLOUD_LOCATION=y
CONFIG_NRF_CLOUD_LOG_LEVEL_INF=y
CONFIG_NRF_CLOUD_GPS_LOG_LEVEL_INF=y
CONFIG_DATE_TIME=y
CONFIG_MODEM_INFO=y
CONFIG_MODEM_INFO_ADD_DATE_TIME=n
CONFIG_AT_MONITOR=y
CONFIG_MODEM_JWT=y
CONFIG_NRF_CLOUD_CLIENT_ID_SRC_INTERNAL_UUID=y



#
# Copyright (c) 2019 Nordic Semiconductor ASA
#
# SPDX-License-Identifier: LicenseRef-BSD-5-Clause-Nordic
#

# General config
CONFIG_ASSERT=y
CONFIG_HWINFO=y
CONFIG_REBOOT=y
CONFIG_NCS_SAMPLES_DEFAULTS=y

# Console
CONFIG_CONSOLE_SUBSYS=y
CONFIG_CONSOLE_HANDLER=y
CONFIG_CONSOLE_GETCHAR=y

# My config
CONFIG_UART_INTERRUPT_DRIVEN=y

# PWM for the buzzer
CONFIG_PWM=y

# Drivers
CONFIG_SENSOR=y
CONFIG_EEPROM=y
CONFIG_EEPROM_AT24=y
CONFIG_IIS2DLPC=y
#CONFIG_BME280=y

# Network
CONFIG_NET_SOCKETS_OFFLOAD=y

# LTE link control
CONFIG_LTE_LINK_CONTROL=y
CONFIG_LTE_AUTO_INIT_AND_CONNECT=n

CONFIG_LTE_NETWORK_MODE_NBIOT=y
CONFIG_LTE_NETWORK_MODE_LTE_M=n
CONFIG_LTE_NETWORK_USE_FALLBACK=n

CONFIG_LTE_PSM_REQ_RPTAU="00000110"
CONFIG_LTE_PSM_REQ_RAT="00000010"

#CONFIG_LTE_NETWORK_MODE_NBIOT_GPS=n
#CONFIG_LTE_NETWORK_MODE_LTE_M_GPS=n
#CONFIG_LTE_LINK_CONTROL_LOG_LEVEL_DBG=y
#CONFIG_POWER_OPTIMIZATION_ENABLE=n

CONFIG_MODEM_KEY_MGMT=y
CONFIG_NORDIC_SECURITY_BACKEND=y

# AT Host
CONFIG_AT_HOST_LIBRARY=y

# JSON
CONFIG_JSON_LIBRARY=y

# MQTT
CONFIG_MQTT_LIB=y
CONFIG_MQTT_LIB_TLS=y

# Stacks and heaps
CONFIG_HW_STACK_PROTECTION=y

# Fatal error
CONFIG_RESET_ON_FATAL_ERROR=y
CONFIG_WATCHDOG=n

# Appliaction
#CONFIG_UPDATE_HOST="euros-embedded.s3.eu-central-1.amazonaws.com"
#CONFIG_UPDATE_HOST="gvalkov.com"
CONFIG_UPDATE_HOST="protec3.io:888"
#CONFIG_UPDATE_HOST="87.118.177.198"
#CONFIG_UPDATE_HOST="87.138.172.131"
CONFIG_UPDATE_FILE="/update/app_update.bin"
CONFIG_UPDATE_VERSION=1
CONFIG_UPDATE_USE_HTTPS=n

# APN provision, needed by AT&T cards
# depricated: PDP
#CONFIG_LTE_PDP_CMD=y
#CONFIG_LTE_PDP_CONTEXT="1,\"IP\",\"lp.swir\""
#CONFIG_LTE_PDP_CONTEXT="1,\"IP\",\"iot.aer.net\""
```

## src/apn.h
```c
#ifndef GUARD_APN_H
#define GUARD_APN_H

#include <zephyr/kernel.h>
#include <zephyr/data/json.h>
#include "eeprom.h"

#define APN_MAX_LENGTH 32
#define APN_MAX_IDENTIFIER_LENGTH 9

struct apn_table_entry
{
#if 0
	uint8_t length;
	char identifier[APN_MAX_IDENTIFIER_LENGTH];
	char apn[APN_MAX_LENGTH];
#else
	char identifier[APN_MAX_IDENTIFIER_LENGTH];
	uint8_t select;
#endif
};

// APN config in EEPROM
struct eeprom_apn_config
{
	// 0 custom APN
	// 1-255 predefined APNs stored in the firmware
	uint8_t select;
	char APN[APN_MAX_LENGTH];
};

struct apn_get_req
{
	const char * config;
};

struct apn_set_req
{
	const char * config;
	int select;
	const char * APN;
};

int apn_read(struct eeprom_apn_config * apn_config, const char * iccid);

void apn_get(
	char * raw_buf,
	size_t len,
	struct eeprom_apn_config * apn_config
);

int apn_set(char * raw_buf, size_t len, struct eeprom_apn_config * apn_config);

#endif /* GUARD_APN_H */
```

## src/aws.c
```c
#include <zephyr/kernel.h>
#include <modem/nrf_modem_lib.h>
#include <modem/modem_info.h>
#include <modem/lte_lc.h>
//-#include <modem/at_cmd.h>
#include <zephyr/net/socket.h>
#include <nrf_socket.h>
#include <stdio.h>
#include <zephyr/net/tls_credentials.h>
#include <modem/modem_key_mgmt.h>
#include <zephyr/net/mqtt.h>

#include "gpio_t.h"
#include "mqtt_handler.h"
#include "main.h"
#include "aws.h"


#define CONFIG_COAP_SERVER_PORT 61002
#define CONFIG_COAP_SERVER_HOSTNAME "84.40.94.129"

LOG_MODULE_REGISTER(aws, CONFIG_PROTEC3_LOG_LEVEL);

static struct sockaddr_storage server;

static struct rsrp_data rsrp =
{
	.value = 0,
};

static struct modem_param_info modem_param;

static sec_tag_t sec_tag_list[] = { 13496857 };

static const char ca_cert[] =
{
	#include "../certs/ca.crt"
};

static const char private_cert[] =
{
	#include "../certs/client.crt"
};

static const char private_key[] =
{
	#include "../certs/client.key"
};

/* Buffers for MQTT client. */
static uint8_t rx_buffer[MQTT_MESSAGE_BUFFER_SIZE];
static uint8_t tx_buffer[MQTT_MESSAGE_BUFFER_SIZE];
static uint8_t payload_buf[MQTT_PAYLOAD_BUFFER_SIZE + 1];

/* The mqtt client struct */
struct mqtt_client client;

/* MQTT Broker details. */
static struct sockaddr_storage broker;

/* Connected flag */
static bool connected;

/* File descriptor */
static struct pollfd fds;

/************************************************ Functions ********************************************/

static int server_resolve(void)
{
	int err;
	struct addrinfo * result;

	struct addrinfo hints =
	{
		.ai_flags = AI_NUMERICHOST,
		.ai_family = AF_INET,
		.ai_socktype = SOCK_DGRAM
	};

	char ipv4_addr[NET_IPV4_ADDR_LEN];

	err = getaddrinfo(CONFIG_COAP_SERVER_HOSTNAME, NULL, &hints, &result);

	if (err != 0)
	{
		LOG_ERR("ERROR: getaddrinfo failed %d\n", err);
		return -EIO;
	}

	if (result == NULL)
	{
		LOG_ERR("ERROR: Address not found\n");
		return -ENOENT;
	}

	struct sockaddr_in * server4 = ((struct sockaddr_in *)&server);

	server4->sin_addr.s_addr = ((struct sockaddr_in *)result->ai_addr)->sin_addr.s_addr;
	server4->sin_family = AF_INET;
	server4->sin_port = htons(CONFIG_COAP_SERVER_PORT);

	inet_ntop(AF_INET, &server4->sin_addr.s_addr, ipv4_addr, sizeof(ipv4_addr));
	printk("IPv4 Address found %s\n", ipv4_addr);

	freeaddrinfo(result);

	return 0;
}

static void modem_rsrp_handler(char rsrp_value)
{
	if (rsrp_value > 97)
	{
		return;
	}

	rsrp.value = rsrp_value;

	char buffer[CONFIG_MODEM_INFO_BUFFER_SIZE] = { 0 };
	int32_t rsrp_current;
	size_t len;
	rsrp_current = RSRP_IDX_TO_DBM(rsrp.value);

	len = snprintf(buffer, CONFIG_MODEM_INFO_BUFFER_SIZE, "signal strength: %d dBm", rsrp_current);
	printk("%s\n", buffer);

}

static void modem_data_init(void)
{
	int err;
	err = modem_info_init();

	if (err)
	{
		printk("Modem info could not be established: %d\n", err);
		return;
	}

	modem_info_params_init(&modem_param);
	modem_info_rsrp_register(modem_rsrp_handler);
}

int cert_provision1(nrf_sec_tag_t sec_tag, enum modem_key_mgmt_cred_type cred_type, const void * buf, size_t len)
{
	int err;
	bool exists;

	err = modem_key_mgmt_exists(sec_tag, cred_type, &exists);

	if (err)
	{
		printk("Failed to check for certificates err %d\n", err);
		return err;
	}

	//if (exists)
	//{
	//	/* For the sake of simplicity we delete what is provisioned
	//	 * with our security tag and reprovision our certificate.
	//	 */
	//	err = modem_key_mgmt_delete(sec_tag, cred_type);
	//
	//	if (err)
	//	{
	//		printk("Failed to delete existing certificate, err %d\n", err);
	//	}
	//}


	if (!exists)
	{
		printk("Provisioning certificate\n");

		/* Provision certificate to the modem */
		err = modem_key_mgmt_write(sec_tag, cred_type, buf, len - 1);

		if (err)
		{
			printk("Failed to provision certificate, err %d\n", err);
			return err;
		}
	}
	else
	{
		printk("Certificate already provisioned\n");
	}


	return 0;
}

/* TODO should be a libary function, but I couldn't get the library included
   cf. https://developer.nordicsemi.com/nRF_Connect_SDK/doc/latest/zephyr/reference/random/index.html?highlight=sys_rand#c.sys_rand32_get
 */
uint32_t sys_rand32_get(void)
{
	/* algorithm from EUROS soruces */
	static uint32_t seed = 0;

	if (!seed)
	{
		seed = k_uptime_get_32();
	}

	seed = seed * 1103515245L + 12345L;

	return seed >> 16;
}

/**@brief Function to print strings without null-termination
 */
static void data_print(const uint8_t * prefix, const uint8_t * data, size_t len)
{
	char buf[len + 1];

	memcpy(buf, data, len);
	buf[len] = 0;
	printk("%s%s\n", prefix, buf);
}

int data_publish1(
	struct mqtt_client * c,
	enum mqtt_qos qos,
	const uint8_t * subtopic,
	/*const */uint8_t * data
)
{
	uint8_t topic[64];
	struct mqtt_publish_param param;

	snprintf(topic, sizeof(topic), "/%s%s", client_id_buf, subtopic);

	param.message.topic.qos = qos;
	param.message.topic.topic.utf8 = topic;
	param.message.topic.topic.size = strlen(topic);
	param.message.payload.data = data;
	param.message.payload.len = strlen(data);
	param.message_id = sys_rand32_get();
	param.dup_flag = 0;
	param.retain_flag = 0;

	printk("MQTT PUB: %s = ", topic);
	data_print("", data, strlen(data));

	return mqtt_publish(c, &param);
}



/**@brief Function to subscribe to the configured topic
 */
static int subscribe(void)
{
	uint8_t alarm[64];
	uint8_t beep[64];
	uint8_t led_[64];
	uint8_t user[64];
	uint8_t uptime[64];

	snprintf(alarm, sizeof(alarm), "/%s/alarm", client_id_buf);
	snprintf(beep, sizeof(beep), "/%s/beep/+", client_id_buf);
	snprintf(led_, sizeof(led_), "/%s/led/+", client_id_buf);
	snprintf(user, sizeof(user), "/%s/user/+", client_id_buf);
	snprintf(uptime, sizeof(uptime), "/%s/uptime", client_id_buf);

	struct mqtt_topic subscribe_topics[] =
	{
		{
			.topic =
			{
				.utf8 = alarm,
				.size = strlen(alarm)
			},
			.qos = MQTT_QOS_1_AT_LEAST_ONCE
		},
		{
			.topic =
			{
				.utf8 = beep,
				.size = strlen(beep)
			},
			.qos = MQTT_QOS_1_AT_LEAST_ONCE
		},
		{
			.topic =
			{
				.utf8 = led_,
				.size = strlen(led_)
			},
			.qos = MQTT_QOS_1_AT_LEAST_ONCE
		},
		{
			.topic =
			{
				.utf8 = user,
				.size = strlen(user)
			},
			.qos = MQTT_QOS_1_AT_LEAST_ONCE
		},
		{
			.topic =
			{
				.utf8 = uptime,
				.size = strlen(uptime)
			},
			.qos = MQTT_QOS_1_AT_LEAST_ONCE
		},
		// TODO add additional topics
	};

	size_t count = sizeof(subscribe_topics) / sizeof(subscribe_topics[0]);

	const struct mqtt_subscription_list subscription_list =
	{
		.list = subscribe_topics,
		.list_count = count,
		.message_id = 1234
	};

	printk("\nMQTT subscribing to %u topics:\n", count);

	size_t i = 0;

	for (i = 0; i < count; i++)
	{
		printk("  %s\n", subscribe_topics[i].topic.utf8);
	}

	printk("\n");

	return mqtt_subscribe(&client, &subscription_list);
}

/**@brief Function to read the published payload.
 */
static int publish_get_payload(struct mqtt_client * c, size_t length)
{
	// reserve space for a NULL terminator
	if (length >= sizeof(payload_buf))
	{
		return -EMSGSIZE;
	}

	uint8_t * buf = payload_buf;
	uint8_t * end = buf + length;

	while (buf < end)
	{
		int count = mqtt_read_publish_payload(c, buf, end - buf);

		if (count < 0)
		{
			int err;

			if (count != -EAGAIN)
			{
				return count;
			}

			printk("mqtt_read_publish_payload: EAGAIN\n");

			err = poll(&fds, 1, CONFIG_MQTT_KEEPALIVE * MSEC_PER_SEC);

			if (err > 0 && (fds.revents & POLLIN) == POLLIN)
			{
				continue;
			}
			else
			{
				return -EIO;
			}
		}

		if (count == 0)
		{
			return -EIO;
		}

		buf += count;
	}

	// add a NULL terminator
	*buf = '\0';

	return 0;
}

/**@brief MQTT client event handler
 */
void mqtt_evt_handler(struct mqtt_client * const c, const struct mqtt_evt * evt)
{
	int err;

	switch (evt->type)
	{
	case MQTT_EVT_CONNACK:
		if (evt->result != 0)
		{
			printk("MQTT connect failed %d\n", evt->result);
			break;
		}

		connected = true;
		printk("[%s:%d] MQTT client connected!\n", __func__, __LINE__);
		int b = subscribe();

		printk(
			"MQTT mqtt_subscribe %i  %s\n",
			b,
			(b == -12) ? "FAIL: check MQTT_MESSAGE_BUFFER_SIZE" : b ? "FAIL" : "OK"
		);

		data_publish1(&client, MQTT_QOS_1_AT_LEAST_ONCE, "/status/link", "ONLINE");

		break;

	case MQTT_EVT_DISCONNECT:
		printk(
			"[%s:%d] MQTT client disconnected %d\n",
			__func__,
			__LINE__,
			evt->result
		);

		connected = false;

		break;

	case MQTT_EVT_PUBLISH:
	{
		const struct mqtt_publish_param * p = &evt->param.publish;

		uint8_t topic[p->message.topic.topic.size + 1];
		snprintf(topic, sizeof(topic), "%s", p->message.topic.topic.utf8);

		printk(
			"[%s:%d] MQTT PUBLISH result=%d len=%d  %s = ",
			__func__,
			__LINE__,
			evt->result,
			p->message.payload.len,
			topic
		);

		err = publish_get_payload(c, p->message.payload.len);

		if (err >= 0)
		{
			printk("%s\n", payload_buf);
			mqtt_publish_h(&client, topic, strlen(topic), payload_buf, p->message.payload.len);

#if 0
			data_publish1(
				&client,
				MQTT_QOS_1_AT_LEAST_ONCE,
				"/status/echo",
				payload_buf
				/*, p->message.payload.len*/
			);
#endif
		}
		else
		{
			printk("ERROR %d\nmqtt_read_publish_payload: Failed!\n", err);
			printk("Disconnecting MQTT client...\n");

			err = mqtt_disconnect(c);

			if (err)
			{
				printk("Could not disconnect: %d\n", err);
			}
		}
	}

	break;

	case MQTT_EVT_PUBACK:
		if (evt->result != 0)
		{
			printk("MQTT PUBACK error %d\n", evt->result);
			break;
		}

		printk(
			"[%s:%d] PUBACK packet id: %u\n",
			__func__,
			__LINE__,
			evt->param.puback.message_id
		);

		break;

	case MQTT_EVT_SUBACK:
		if (evt->result != 0)
		{
			printk("MQTT SUBACK error %d\n", evt->result);
			break;
		}

		printk(
			"[%s:%d] SUBACK packet id: %u\n",
			__func__,
			__LINE__,
			evt->param.suback.message_id
		);

		break;

	default:
		printk(
			"[%s:%d] default: %d\n",
			__func__,
			__LINE__,
			evt->type
		);

		break;
	}
}

/**@brief Resolves the configured hostname and
 * initializes the MQTT broker structure
 */
static void broker_init(void)
{
	int err;
	struct addrinfo * result;
	struct addrinfo * addr;
	struct addrinfo hints =
	{
		.ai_family = AF_INET,
		.ai_socktype = SOCK_STREAM
	};


	struct nrf_in_addr dns;
	dns.s_addr = 0x08080808; // Google DNS, 8.8.8.8
	err = nrf_setdnsaddr(NRF_AF_INET, &dns, sizeof(dns));
	printk("LTE| set DNS: %d\n", err);

	err = getaddrinfo(MQTT_BROKER_HOSTNAME, NULL, &hints, &result);

	if (err)
	{
		printk("ERROR: getaddrinfo failed %d\n", err);

		return;
	}

	addr = result;
	err = -ENOENT;

	/* Look for address of the broker. */
	while (addr != NULL)
	{
		/* IPv4 Address. */
		if (addr->ai_addrlen == sizeof(struct sockaddr_in))
		{
			struct sockaddr_in * broker4 = ((struct sockaddr_in *)&broker);
			char ipv4_addr[NET_IPV4_ADDR_LEN];

			broker4->sin_addr.s_addr = ((struct sockaddr_in *)addr->ai_addr)->sin_addr.s_addr;
			broker4->sin_family = AF_INET;
			broker4->sin_port = htons(MQTT_BROKER_PORT);

			inet_ntop(AF_INET, &broker4->sin_addr.s_addr, ipv4_addr, sizeof(ipv4_addr));
			printk("IPv4 Address found %s\n", ipv4_addr);

			break;
		}
		else
		{
			printk(
				"ai_addrlen = %u should be %u or %u\n",
				(unsigned int)addr->ai_addrlen,
				(unsigned int)sizeof(struct sockaddr_in),
				(unsigned int)sizeof(struct sockaddr_in6)
			);
		}

		addr = addr->ai_next;
		break;
	}

	/* Free the address. */
	freeaddrinfo(result);
}

/**@brief Initialize the MQTT client structure
 */
static void client_init(struct mqtt_client * client)
{
	static struct mqtt_utf8 password;
	static struct mqtt_utf8 user_name;
	static struct mqtt_utf8 will_message;
	static struct mqtt_topic will_topic;
	static struct mqtt_utf8 will_topic_topic;

	static uint8_t client_id[64];
	static uint8_t topic[64];

	mqtt_client_init(client);

	broker_init();

	/* MQTT client configuration */
	client->broker = &broker;
	client->evt_cb = mqtt_evt_handler;

	snprintf(client_id, sizeof(client_id), "protec3-%s", client_id_buf);
	client->client_id.utf8 = (uint8_t *)client_id;
	client->client_id.size = strlen(client_id);

	password.utf8 = MQTT_CLIENT_PASSWORD;
	password.size = strlen(password.utf8);
	client->password = &password;

	user_name.utf8 = (uint8_t *)MQTT_CLIENT_USERNAME;
	user_name.size = strlen(user_name.utf8);
	client->user_name = &user_name;

	will_message.utf8 = (uint8_t *)"OFFLINE";
	will_message.size = strlen(will_message.utf8);
	client->will_message = &will_message;

	snprintf(topic, sizeof(topic), "/%s/status/link", client_id_buf);
	will_topic_topic.utf8 = topic;
	will_topic_topic.size = strlen(topic);

	will_topic.qos = MQTT_QOS_2_EXACTLY_ONCE;
	will_topic.topic = will_topic_topic;
	client->will_topic = &will_topic;

	client->protocol_version = MQTT_VERSION_3_1_1;

	//printk("username: %s, password: %s\n", client->user_name->utf8, client->password->utf8);

	/* MQTT buffers configuration */
	client->rx_buf = rx_buffer;
	client->rx_buf_size = sizeof(rx_buffer);
	client->tx_buf = tx_buffer;
	client->tx_buf_size = sizeof(tx_buffer);

	/* MQTT transport configuration */
#if defined(CONFIG_MQTT_LIB_TLS)
	struct mqtt_sec_config * tls_config = &client->transport.tls.config;

	client->transport.type = MQTT_TRANSPORT_SECURE;

	tls_config->peer_verify = PEER_VERIFY;
	tls_config->cipher_count = 0;
	tls_config->cipher_list = NULL;
	tls_config->sec_tag_count = ARRAY_SIZE(sec_tag_list);
	tls_config->sec_tag_list = sec_tag_list;
	tls_config->hostname = MQTT_BROKER_HOSTNAME;
#else /* MQTT transport configuration */
	client->transport.type = MQTT_TRANSPORT_NON_SECURE;
#endif /* defined(CONFIG_MQTT_LIB_TLS) */

		/* worker_queue to handle received data */
		mqtt_work_queue_init();
}

/**@brief Initialize the file descriptor structure used by poll.
 */
static int fds_init(struct mqtt_client * c)
{
	if (c->transport.type == MQTT_TRANSPORT_NON_SECURE)
	{
		fds.fd = c->transport.tcp.sock;
	}
	else
	{
#if defined(CONFIG_MQTT_LIB_TLS)
		fds.fd = c->transport.tls.sock;
#else
		return -ENOTSUP;
#endif
	}

	fds.events = POLLIN;

	return 0;
}

void modem_thread(void)
{
	struct modem_param_info * modem_ptr = NULL;
	int ret, err;

	char buffer[CONFIG_MESSAGE_BUFFER_SIZE] = { 0 };

	k_msleep(100);
	printk("Starting LTE link initialization\n");

	/* Provision certificates before connecting to the LTE network */
	err = cert_provision1(
		sec_tag_list[0],
		MODEM_KEY_MGMT_CRED_TYPE_CA_CHAIN,
		ca_cert,
		sizeof(ca_cert)
	);

	if (err)
	{
		printk("Failed to install ca_cert\n");
	}

	err = cert_provision1(
		sec_tag_list[0],
		MODEM_KEY_MGMT_CRED_TYPE_PUBLIC_CERT,
		private_cert,
		sizeof(private_cert)
	);

	if (err)
	{
		printk("Failed to install client cert\n");
	}

	err = cert_provision1(
		sec_tag_list[0],
		MODEM_KEY_MGMT_CRED_TYPE_PRIVATE_CERT,
		private_key,
		sizeof(private_key)
	);

	if (err)
	{
		printk("Failed to install client key\n");
	}

	// init button and LED
	led_init();
	//+btn_init();
	lte_init();

	k_sem_take(&thread_sync_sem, K_FOREVER);

	//lte_lc_init_and_connect();
	server_resolve();
	printk("LTE link initialization done\n");

	client_init(&client);

	modem_data_init();

	while (1)
	{
		ret = modem_info_params_get(&modem_param);

		if (ret < 0)
		{
			printk("Unable to obtain modem parameters: %d\n", ret);
		}
		else
		{
			modem_ptr = &modem_param;

			if (IS_ENABLED(CONFIG_MODEM_INFO_ADD_NETWORK))
			{
				int count = snprintf(
					buffer,
					CONFIG_MESSAGE_BUFFER_SIZE,
					"operator id: %s, area code: %s (%d), cell id: %s (%d), band: %d, ip: %s, apn: %s, mode: %s",
					modem_ptr->network.current_operator.value_string,
					modem_ptr->network.area_code.value_string,
					modem_ptr->network.area_code.value,
					modem_ptr->network.cellid_hex.value_string,
					(int)modem_ptr->network.cellid_dec,
					modem_ptr->network.current_band.value,
					modem_ptr->network.ip_address.value_string,
					modem_ptr->network.apn.value_string,
					(modem_ptr->network.nbiot_mode.value == 1 && modem_ptr->network.gps_mode.value == 1 ? "NB-IoT, GPS" :
						(modem_ptr->network.lte_mode.value == 1 && modem_ptr->network.gps_mode.value == 1 ? "LTE-M, GPS" :
							(modem_ptr->network.nbiot_mode.value == 0 && modem_ptr->network.lte_mode.value == 0 && modem_ptr->network.gps_mode.value == 1 ? "GPS" :
								"unknown"
								)
							)
						)
				);

				buffer[count] = '\0';
				printk("%s\n", buffer);

				if (IS_ENABLED(CONFIG_MODEM_INFO_ADD_DATE_TIME))
				{
					snprintf(buffer, CONFIG_MESSAGE_BUFFER_SIZE, "network time: %s", modem_ptr->network.date_time.value_string);
					printk("%s\n", buffer);
				}
			}
		}

		err = mqtt_connect(&client);

		if (err != 0)
		{
			printk("ERROR: mqtt_connect %d\n", err);
			//return;
		}
		else
		{

			err = fds_init(&client);

			if (err != 0)
			{
				printk("ERROR: fds_init %d\n", err);
				//return;
			}
			else
			{

				while (1)
				{
					err = poll(&fds, 1, mqtt_keepalive_time_left(&client));

					if (err < 0)
					{
						printk("ERROR: poll %d\n", errno);
						break;
					}

					err = mqtt_live(&client);

					if ((err != 0) && (err != -EAGAIN))
					{
						printk("ERROR: mqtt_live %d\n", err);
						break;
					}

					if ((fds.revents & POLLIN) == POLLIN)
					{
						err = mqtt_input(&client);
						if (err != 0)
						{
							printk("ERROR: mqtt_input %d\n", err);
							break;
						}
					}

					if ((fds.revents & POLLERR) == POLLERR)
					{
						printk("POLLERR\n");
						break;
					}

					if ((fds.revents & POLLNVAL) == POLLNVAL)
					{
						printk("POLLNVAL\n");
						break;
					}

				}

				printk("Disconnecting MQTT client...\n");

				err = mqtt_disconnect(&client);

				if (err)
				{
					printk("Could not disconnect MQTT client. Error: %d\n", err);
				}
			}
		}

		k_sleep(K_SECONDS(30));
	}
}


K_THREAD_DEFINE(modem_thread_id, 4096, modem_thread, NULL, NULL, NULL, 7, 0, 0);
```

## src/bme280.c
```c
/*
 * Copyright (c) 2016 Open-RnD Sp. z o.o.
 * Copyright (c) 2020 Nordic Semiconductor ASA
 *
 * SPDX-License-Identifier: Apache-2.0
 */

#include <zephyr/kernel.h>
#include <stdio.h>
#include <zephyr/device.h>
#include <inttypes.h>
#include <string.h>
#include <zephyr/sys/util.h>
#include <zephyr/sys/printk.h>
#include <zephyr/drivers/gpio.h>
#include <zephyr/drivers/uart.h>
#include <zephyr/drivers/i2c.h>
#include <zephyr/drivers/eeprom.h>
#include <zephyr/drivers/sensor.h>
#include <modem/nrf_modem_lib.h>
#include <modem/modem_info.h>
#include <modem/lte_lc.h>
//-#include <modem/at_cmd.h>
#include <zephyr/net/socket.h>
#include <nrf_socket.h>
#include <nrf_modem.h>
#include <zephyr/sys/reboot.h>

#include <adp536x-mod.h>
#include <buzzer.h>


 /********************* BME280 ******************************************/
#include "BME280_driver-bme280_v3.5.0/bme280.h"
/********************** END BME *****************************************/


/********************** BME280 ******************************************/
typedef struct
{
	const struct device * i2c2_dev;
	uint16_t dev_addr;
} tDevDataForBME;

/*!
 * @brief Bus communication function pointer which should be mapped to
 * the platform specific read functions of the user
 *
 * @param[in] reg_addr       : Register address from which data is read.
 * @param[out] reg_data      : Pointer to data buffer where read data is stored.
 * @param[in] len            : Number of bytes of data to be read.
 * @param[in, out] intf_ptr  : Void pointer that can enable the linking of descriptors
 *                                  for interface related call backs.
 *
 * @retval   0 -> Success.
 * @retval Non zero value -> Fail.
 *
 */
static BME280_INTF_RET_TYPE bme280_i2c_read(uint8_t reg_addr, uint8_t * reg_data, uint32_t len, void * intf_ptr)
{
	tDevDataForBME * devData = (tDevDataForBME *)intf_ptr;

	return i2c_write_read(
		devData->i2c2_dev,
		devData->dev_addr,
		&reg_addr,
		sizeof(reg_addr),
		reg_data,
		len
	);
}

/*!
 * @brief Bus communication function pointer which should be mapped to
 * the platform specific write functions of the user
 *
 * @param[in] reg_addr      : Register address to which the data is written.
 * @param[in] reg_data      : Pointer to data buffer in which data to be written
 *                            is stored.
 * @param[in] len           : Number of bytes of data to be written.
 * @param[in, out] intf_ptr : Void pointer that can enable the linking of descriptors
 *                            for interface related call backs
 *
 * @retval   0   -> Success.
 * @retval Non zero value -> Fail.
 *
 */
static BME280_INTF_RET_TYPE bme280_i2c_write(uint8_t reg_addr, const uint8_t * reg_data, uint32_t len, void * intf_ptr)
{
	tDevDataForBME * devData = (tDevDataForBME *)intf_ptr;

	return i2c_burst_write(
		devData->i2c2_dev,
		devData->dev_addr,
		reg_addr,
		reg_data,
		len
	);
}

/*!
 * @brief Delay function pointer which should be mapped to
 * delay function of the user
 *
 * @param[in] period              : Delay in microseconds.
 * @param[in, out] intf_ptr       : Void pointer that can enable the linking of descriptors
 *                                  for interface related call backs
 *
 */
static void bme280_delay(uint32_t period, void * intf_ptr)
{
	k_usleep(period);
}

void bme280_print_sensor_data(struct bme280_data * comp_data)
{
#ifdef BME280_FLOAT_ENABLE
	printf("%0.2f, %0.2f, %0.2f\r\n", comp_data->temperature, comp_data->pressure, comp_data->humidity);
#else
	printf("%ld, %ld, %ld\r\n", comp_data->temperature, comp_data->pressure, comp_data->humidity);
#endif
}

void bme280_init_api(const struct device * i2c_dev)
{
	struct bme280_dev dev;
	int8_t rslt = BME280_OK;
	tDevDataForBME devDataForBME = { i2c_dev, BME280_I2C_ADDR_SEC };

	dev.intf_ptr = &devDataForBME;
	dev.intf = BME280_I2C_INTF;
	dev.read = bme280_i2c_read;
	dev.write = bme280_i2c_write;
	dev.delay_us = bme280_delay;
	rslt = bme280_init(&dev);

	if (BME280_OK == rslt)
	{
		uint8_t settings_sel;
		struct bme280_data comp_data;

		/* Recommended mode of operation: Indoor navigation */
		dev.settings.osr_h = BME280_OVERSAMPLING_1X;
		dev.settings.osr_p = BME280_OVERSAMPLING_16X;
		dev.settings.osr_t = BME280_OVERSAMPLING_2X;
		dev.settings.filter = BME280_FILTER_COEFF_16;
		dev.settings.standby_time = BME280_STANDBY_TIME_62_5_MS;

		settings_sel = BME280_OSR_PRESS_SEL;
		settings_sel |= BME280_OSR_TEMP_SEL;
		settings_sel |= BME280_OSR_HUM_SEL;
		settings_sel |= BME280_STANDBY_SEL;
		settings_sel |= BME280_FILTER_SEL;

		rslt = bme280_set_sensor_settings(settings_sel, &dev);
		rslt = bme280_set_sensor_mode(BME280_NORMAL_MODE, &dev);
		printf("BME280: Temperature, Pressure, Humidity\r\n");

		dev.delay_us(70, dev.intf_ptr);

		rslt = bme280_get_sensor_data(BME280_ALL, &comp_data, &dev);
		bme280_print_sensor_data(&comp_data);
	}
	else
	{
		printk("bme280_init_api() failed %d\n", rslt);
	}
}

/********************** END BME *****************************************/
```

## src/buzzer.c
```c
/*
 * Copyright (c) 2019 Nordic Semiconductor ASA
 *
 * SPDX-License-Identifier: LicenseRef-BSD-5-Clause-Nordic
 */

#include <zephyr/kernel.h>
#include <zephyr/drivers/pwm.h>
#include <zephyr/drivers/gpio.h>

//#include "ui.h"
#include "buzzer.h"

#include <zephyr/logging/log.h>
LOG_MODULE_REGISTER(buzzer, 3);

#define CONFIG_UI_BUZZER_PWM_DEV_NAME "PWM_1"
#define CONFIG_UI_BUZZER_PIN 0
#define CONFIG_UI_BUZZER_MIN_FREQUENCY 1000
#define CONFIG_UI_BUZZER_MAX_FREQUENCY 5000

#define BUZZER_MIN_FREQUENCY		CONFIG_UI_BUZZER_MIN_FREQUENCY
#define BUZZER_MAX_FREQUENCY		CONFIG_UI_BUZZER_MAX_FREQUENCY
#define BUZZER_MIN_INTENSITY		0
#define BUZZER_MAX_INTENSITY		100
#define BUZZER_MIN_DUTY_CYCLE_DIV	100
#define BUZZER_MAX_DUTY_CYCLE_DIV	2

#define BUZZER_ENABLE_PIN 2

#define log_strdup(x) x

const struct device * pwm_dev = NULL;
const struct device * gpio0 = NULL;
static atomic_t buzzer_enabled;

static uint32_t intensity_to_duty_cycle_divisor(uint8_t intensity)
{
	return MIN(
		MAX(
			((intensity - BUZZER_MIN_INTENSITY) *
				(BUZZER_MAX_DUTY_CYCLE_DIV - BUZZER_MIN_DUTY_CYCLE_DIV) /
				(BUZZER_MAX_INTENSITY - BUZZER_MIN_INTENSITY) +
				BUZZER_MIN_DUTY_CYCLE_DIV),
			BUZZER_MAX_DUTY_CYCLE_DIV),
		BUZZER_MIN_DUTY_CYCLE_DIV);
}

static int pwm_out(uint32_t frequency, uint8_t intensity)
{
	static uint32_t prev_period;
	uint32_t period = (frequency > 0) ? USEC_PER_SEC / frequency : 0;
	uint32_t duty_cycle = (intensity == 0) ? 0 : period / intensity_to_duty_cycle_divisor(intensity);

	/* Applying workaround due to limitations in PWM driver that doesn't
	 * allow changing period while PWM is running. Setting pulse to 0
	 * disables the PWM, but not before the current period is finished.
	 */
	if (prev_period)
	{
		pwm_set(pwm_dev, CONFIG_UI_BUZZER_PIN, PWM_USEC(prev_period), 0, 0);
		//-pwm_pin_set_usec(pwm_dev, CONFIG_UI_BUZZER_PIN, prev_period, 0, 0);
		k_sleep(K_MSEC(MAX((prev_period / USEC_PER_MSEC), 1)));
	}

	prev_period = period;

	return pwm_set(pwm_dev, CONFIG_UI_BUZZER_PIN, PWM_USEC(period), duty_cycle, 0);
	//-return pwm_pin_set_usec(pwm_dev, CONFIG_UI_BUZZER_PIN, period, duty_cycle, 0);
}

static void buzzer_disable(void)
{
	atomic_set(&buzzer_enabled, 0);

	pwm_out(0, 0);
	gpio_pin_set(gpio0, BUZZER_ENABLE_PIN, 0);


#ifdef CONFIG_DEVICE_POWER_MANAGEMENT
	int err = device_set_power_state(pwm_dev, DEVICE_PM_SUSPEND_STATE, NULL, NULL);

	if (err)
	{
		LOG_ERR("PWM disable failed");
	}
#endif
}

static int buzzer_enable(void)
{
	int err = 0;

	atomic_set(&buzzer_enabled, 1);
	gpio_pin_set(gpio0, BUZZER_ENABLE_PIN, 1);

#ifdef CONFIG_DEVICE_POWER_MANAGEMENT
	err = device_set_power_state(pwm_dev, DEVICE_PM_ACTIVE_STATE, NULL, NULL);

	if (err)
	{
		LOG_ERR("PWM enable failed");
		return err;
	}
#endif

	return err;
}

int ui_buzzer_init(void)
{
	const char dev_name[] = CONFIG_UI_BUZZER_PWM_DEV_NAME;
	int err = 0;

	gpio0 = device_get_binding("GPIO_0");

	if (gpio0 == NULL)
	{
		printk("Buzzer init: error, no GPIO device!\n");
		return -ENODEV;
	}

	if (
		gpio_pin_configure(gpio0, 1, GPIO_OUTPUT) == 0 &&
		gpio_pin_configure(gpio0, BUZZER_ENABLE_PIN, GPIO_OUTPUT) == 0
		)
	{
		if (
			gpio_pin_set(gpio0, 1, 0) == 0 &&
			gpio_pin_set(gpio0, BUZZER_ENABLE_PIN, 0) == 0
			)
		{
			pwm_dev = device_get_binding(dev_name);

			if (!pwm_dev)
			{
				LOG_ERR("Could not bind to device %s", log_strdup(dev_name));
				err = -ENODEV;
			}
		}
	}

	//buzzer_enable();

	return err;
}

int ui_buzzer_set_frequency(uint32_t frequency, uint8_t intensity)
{
	if (pwm_dev == NULL)
	{
		LOG_DBG("Buzzer is not initialized!\n");
		return -ENODEV;
	}

	if (frequency == 0 || intensity == 0)
	{
		LOG_DBG("Frequency set to 0, disabling PWM\n");
		buzzer_disable();
		return 0;
	}

	if (
		(frequency < BUZZER_MIN_FREQUENCY) ||
		(frequency > BUZZER_MAX_FREQUENCY)
		)
	{
		return -EINVAL;
	}

	if (
		(intensity < BUZZER_MIN_INTENSITY) ||
		(intensity > BUZZER_MAX_INTENSITY)
		)
	{
		return -EINVAL;
	}

	if (!atomic_get(&buzzer_enabled))
	{
		buzzer_enable();
	}

	return pwm_out(frequency, intensity);
}
```

## src/buzzer.h
```c
/*
 * Copyright (c) 2019 Nordic Semiconductor ASA
 *
 * SPDX-License-Identifier: LicenseRef-BSD-5-Clause-Nordic
 */
/**@file
 *
 * @brief   Buzzer control for the User Interface module. The module uses PWM to
 *	    control the buzzer output frequency.
 */

#ifndef UI_BUZZER_H__
#define UI_BUZZER_H__

#include <zephyr/kernel.h>

#ifdef __cplusplus
extern "C" {
#endif

/**@brief Initialize buzzer in the user interface module. */
int ui_buzzer_init(void);
int ui_buzzer_set_frequency(uint32_t frequency, uint8_t intensity);

#ifdef __cplusplus
}
#endif

#endif /* UI_BUZZER_H__ */
```

## src/eeprom.h
```c
#ifndef GUARD_EEPROM_H
#define GUARD_EEPROM_H

#include <zephyr/drivers/eeprom.h>

#define OK 0
#define FAIL -1

extern const struct device * eeprom_dev;
extern struct eeprom_apn_config apn_config;

// EEPROM layout
enum EEPROM_ADDRESS
{
	EEPROM_ADDRESS_STARTUP_COUNT = 0,
	EEPROM_ADDRESS_UPDATE_STATUS = 4,
	EEPROM_ADDRESS_APN = 5,
};

#endif /*GUARD_EEPROM_H*/
```

## src/fota_update.c
```c
/*
 * Copyright (c) 2016 Open-RnD Sp. z o.o.
 * Copyright (c) 2020 Nordic Semiconductor ASA
 *
 * SPDX-License-Identifier: Apache-2.0
 */

#include <zephyr/kernel.h>
#include <stdio.h>
#include <zephyr/device.h>
#include <inttypes.h>
#include <string.h>
#include <zephyr/sys/util.h>
#include <zephyr/sys/printk.h>
#include <zephyr/drivers/gpio.h>
#include <zephyr/drivers/uart.h>
#include <zephyr/drivers/i2c.h>
#include <zephyr/drivers/eeprom.h>
#include <zephyr/drivers/sensor.h>
#include <modem/nrf_modem_lib.h>
#include <modem/modem_info.h>
#include <modem/lte_lc.h>
//-#include <modem/at_cmd.h>
#include <zephyr/net/socket.h>
#include <nrf_socket.h>
#include <nrf_modem.h>
#include <zephyr/sys/reboot.h>

#include <adp536x-mod.h>
#include <buzzer.h>

/***************** FOTA ****************/
#include <zephyr/logging/log.h>
#include <zephyr/dfu/mcuboot.h>
#include <zephyr/data/json.h>
#include <dfu/dfu_target.h>
#include <net/download_client.h>
#include <net/fota_download.h>
#include <pm_config.h>
#include <mbedtls/sha1.h>
#include "fota_update.h"
/***************** END FOTA ***********/


#define OK 0
#define FAIL -1


/************************ FOTA ***********************/
LOG_MODULE_REGISTER(fota_update, CONFIG_FOTA_DOWNLOAD_LOG_LEVEL);

struct k_work	fota_work;
static struct download_client udc;
static fota_download_callback_t callback;
//static bl_sha256_ctx_t ctx256;
static mbedtls_sha1_context ctx1;
static mbedtls_sha1_context ctx_packet;
static uint8_t sha1_expected[20];
static fota_finish_t ff;

struct upload_data
{
	int offset;
	int count;
	const char * checksum;
};

struct json_obj_descr upload_descr[] =
{
	JSON_OBJ_DESCR_PRIM(struct upload_data, offset, JSON_TOK_NUMBER),
	JSON_OBJ_DESCR_PRIM(struct upload_data, count, JSON_TOK_NUMBER),
	JSON_OBJ_DESCR_PRIM(struct upload_data, checksum, JSON_TOK_STRING)
};

/**@brief Start transfer of the file. */
static void app_dfu_transfer_start(struct k_work * unused)
{
	int retval;
	int sec_tag;
	//-char * apn = NULL;

#ifndef CONFIG_USE_HTTPS
	sec_tag = -1;
#else
	sec_tag = TLS_SEC_TAG;
#endif

	retval = fota_download_start(
		CONFIG_UPDATE_HOST,
		CONFIG_UPDATE_FILE,
		sec_tag,
		0/*apn*/,
		0
	);

	if (retval != 0)
	{
		/* Re-enable button callback */
		printk("fota_download_start() failed, err %d  %s\n", -retval, strerror(-retval));
	}

}

static void fota_dl_handler(const struct fota_download_evt * evt)
{
	volatile int stop = 1;

	switch (evt->id)
	{
	case FOTA_DOWNLOAD_EVT_ERROR:
		printk("Received error from fota_download\n");
#if 0
		printk("Restartng...\n");
		sys_reboot(SYS_REBOOT_WARM);

		while (stop);
#endif

		break;

	case FOTA_DOWNLOAD_EVT_FINISHED:
		printk("FOTA download succeeded\n\r");
		printk("Restartng...\n");
		//?boot_request_upgrade(BOOT_UPGRADE_PERMANENT);
		sys_reboot(SYS_REBOOT_WARM);

		while (stop);

		break;

	default:
		break;
	}
}

void fota_dl_init(void)
{
	k_work_init(&fota_work, app_dfu_transfer_start);
	int err = fota_download_init(fota_dl_handler);

	if (0 != err)
	{
		printf("fota init failed %i\n\r", err);
		return;
	}

	//printk("FIRMWARE VERSION 2\n");
}

void fota_dl_trigger(void)
{
	printk("FOTA\n");
	//k_sleep(K_MSEC(1000));
	k_work_submit(&fota_work);

	while (1)
	{
		// let fota_work run
		k_sleep(K_MSEC(1000));
	}
}

static void send_evt(enum fota_download_evt_id id)
{
	__ASSERT(id != FOTA_DOWNLOAD_EVT_PROGRESS, "use send_progress");
	__ASSERT(id != FOTA_DOWNLOAD_EVT_ERROR, "use send_error_evt");

	const struct fota_download_evt evt =
	{
		.id = id
	};

	callback(&evt);
}

static void send_error_evt(enum fota_download_error_cause cause)
{
	__ASSERT(cause != FOTA_DOWNLOAD_ERROR_CAUSE_NO_ERROR, "use a valid error cause");

	const struct fota_download_evt evt =
	{
		.id = FOTA_DOWNLOAD_EVT_ERROR,
		.cause = cause
	};

	callback(&evt);
}

static void send_progress(int progress)
{
#ifdef CONFIG_FOTA_DOWNLOAD_PROGRESS_EVT
	const struct fota_download_evt evt =
	{
		.id = FOTA_DOWNLOAD_EVT_PROGRESS,
		.progress = progress
	};

	callback(&evt);
#endif
}

static void dfu_target_callback_handler(enum dfu_target_evt_id evt)
{
	switch (evt)
	{
	case DFU_TARGET_EVT_TIMEOUT:
		send_evt(FOTA_DOWNLOAD_EVT_ERASE_PENDING);
		break;

	case DFU_TARGET_EVT_ERASE_DONE:
		send_evt(FOTA_DOWNLOAD_EVT_ERASE_DONE);
		break;

	default:
		send_error_evt(FOTA_DOWNLOAD_ERROR_CAUSE_DOWNLOAD_FAILED);
	}
}

static int download_client_callback(const struct download_client_evt * event)
{
	static bool first_fragment = true;
	static size_t file_size;
	size_t offset;
	int err;

	if (event == NULL)
	{
		return -EINVAL;
	}

	switch (event->id)
	{
	case DOWNLOAD_CLIENT_EVT_FRAGMENT:
	{
		if (first_fragment)
		{
			err = download_client_file_size_get(&udc, &file_size);

			if (err != 0)
			{
				LOG_DBG("download_client_file_size_get err: %d", err);
				send_error_evt(FOTA_DOWNLOAD_ERROR_CAUSE_DOWNLOAD_FAILED);
				return err;
			}

			first_fragment = false;
			int img_type = dfu_target_img_type(event->fragment.buf, event->fragment.len);
			//-err = dfu_target_init(img_type, file_size, dfu_target_callback_handler);
			err = dfu_target_init(img_type, 0, file_size, dfu_target_callback_handler);

			if ((err < 0) && (err != -EBUSY))
			{
				LOG_ERR("dfu_target_init error %d", err);
				send_error_evt(FOTA_DOWNLOAD_ERROR_CAUSE_DOWNLOAD_FAILED);
				int res = dfu_target_reset();

				if (res != 0)
				{
					LOG_ERR("Unable to reset DFU target");
				}

				first_fragment = true;

				return err;
			}
		}

		err = dfu_target_write(event->fragment.buf, event->fragment.len);

		if (err != 0)
		{
			LOG_ERR("dfu_target_write error %d", err);
			int res = dfu_target_done(false);

			if (res != 0)
			{
				LOG_ERR("Unable to free DFU target resources");
			}

			first_fragment = true;
			send_error_evt(FOTA_DOWNLOAD_ERROR_CAUSE_INVALID_UPDATE);

			return err;
		}

		if (IS_ENABLED(CONFIG_FOTA_DOWNLOAD_PROGRESS_EVT) && !first_fragment)
		{
			err = dfu_target_offset_get(&offset);

			if (err != 0)
			{
				LOG_DBG("unable to get dfu target offset err: %d", err);
				send_error_evt(FOTA_DOWNLOAD_ERROR_CAUSE_DOWNLOAD_FAILED);

				return err;
			}

			if (file_size == 0)
			{
				LOG_DBG("invalid file size: %d", file_size);
				send_error_evt(FOTA_DOWNLOAD_ERROR_CAUSE_DOWNLOAD_FAILED);

				return err;
			}

			send_progress((offset * 100) / file_size);
			LOG_DBG("Progress: %d/%d%%", offset, file_size);
		}

		break;
	}

	case DOWNLOAD_CLIENT_EVT_DONE:
		err = dfu_target_done(true);

		if (err != 0)
		{
			LOG_ERR("dfu_target_done error: %d", err);
			send_error_evt(FOTA_DOWNLOAD_ERROR_CAUSE_DOWNLOAD_FAILED);

			return err;
		}

		send_evt(FOTA_DOWNLOAD_EVT_FINISHED);
		first_fragment = true;

		break;

	case DOWNLOAD_CLIENT_EVT_ERROR:
	{
		/* In case of socket errors we can return 0 to retry/continue,
		 * or non-zero to stop
		 */
		LOG_ERR("Download client error");
		err = dfu_target_done(false);

		if (err == -EACCES)
		{
			LOG_DBG("No DFU target was initialized");
		}
		else if (err != 0)
		{
			LOG_ERR("Unable to deinitialze resources used by dfu_target.");
		}

		first_fragment = true;
		send_error_evt(FOTA_DOWNLOAD_ERROR_CAUSE_DOWNLOAD_FAILED);

		/* Return non-zero to tell download_client to stop */
		return event->error;
	}

	default:
		break;
	}

	return 0;
}



static int fragment_evt_send(const struct download_client * client)
{
	__ASSERT(client->offset <= CONFIG_DOWNLOAD_CLIENT_BUF_SIZE, "Buffer overflow!");

	const struct download_client_evt evt =
	{
		.id = DOWNLOAD_CLIENT_EVT_FRAGMENT,
		.fragment =
		{
			.buf = client->buf,
			.len = client->offset,
		}
	};

	return client->callback(&evt);
}

static int error_evt_send(const struct download_client * dl, int error)
{
	/* Error will be sent as negative. */
	__ASSERT_NO_MSG(error > 0);

	const struct download_client_evt evt =
	{
		.id = DOWNLOAD_CLIENT_EVT_ERROR,
		.error = -error
	};

	return dl->callback(&evt);
}

void uart_download_thread(void * client, void * recv_func, void * send_func)
{
	int64_t time;
	int rc = 0;
	int zero_counter;
	size_t len, req_len;
	char send_buf[128];
	uint8_t check[20];
	uint8_t sha1_computed[20];
	int json_mode;
	struct download_client * const dl = client;
	fota_recv_t fota_recv = recv_func;
	fota_send_t fota_send = send_func;

restart_and_suspend:
	k_thread_suspend(dl->tid);
	mbedtls_sha1_free(&ctx1);
	mbedtls_sha1_init(&ctx1);
	mbedtls_sha1_starts(&ctx1);

	//fota_recv(dl->buf, sizeof(dl->buf), 0, 0);

	time = k_uptime_get();
	json_mode = 1;
	dl->offset = 0;
	dl->progress = 0;
	zero_counter = 0;
	req_len = 128;
	fota_send("update_status={\"status\": \"download-image\"}\n", 43);

	// update_download={"count": 128, "offset": 0, "size": 196358, "progress": 72}
	sprintf(
		send_buf,
		"update_download={\"count\": %u, \"offset\": %u, \"size\": %u, \"progress\": %u}\n",
		MIN(128, (size_t)dl->file_size),
		dl->progress,
		dl->file_size,
		(dl->progress * 100) / dl->file_size
	);

	fota_send(send_buf, strlen(send_buf));

	while (true)
	{
#if 0
		__ASSERT(dl->offset < sizeof(dl->buf), "Buffer overflow");

		if (sizeof(dl->buf) - dl->offset == 0)
		{
			LOG_ERR("Buffer not sufficient (> %d)", sizeof(dl->buf));
			error_evt_send(dl, E2BIG);

			break;
		}

		LOG_DBG(
			"Receiving up to %d bytes at %p...",
			sizeof(dl->buf) - dl->offset,
			dl->buf + dl->offset
		);

#endif

		/*
		len = uart_fifo_read(
			(const struct device*)dl->host,
			dl->buf,
			MIN(sizeof(dl->buf), dl->file_size - dl->progress)
		);
		*/
		len = fota_recv(dl->buf + dl->offset, MIN(sizeof(dl->buf), req_len - dl->offset), json_mode, 0);

		/*len = recv(dl->fd, dl->buf + dl->offset, sizeof(dl->buf) - dl->offset, 0);*/

		if (len == -1)
		{
			/* We just had an unexpected socket error or closure */

			/* If there is a partial data payload in our buffer,
			 * and it has been accounted in our progress, we have
			 * to hand it to the application before discarding it.
			 */

			LOG_ERR("Error in fgets");

			/* Notify the application of the error via en event.
			 * Attempt to reconnect and resume the download
			 * if the application returns Zero via the event.
			 */
			rc = error_evt_send(dl, ECONNRESET);

			if (rc)
			{
				/* Restart and suspend */
				break;
			}

			dl->offset = 0;
			zero_counter = 0;
			continue;
		}

		if (0 == len)
		{
			// more than 1000 ms passed?
			if (k_uptime_get() - time > 1000)
			{
				++zero_counter;

				if (10 <= zero_counter)
				{
					// more than 10 s passed, assume connection is down
					LOG_WRN("No data for 10 s!\n");
					error_evt_send(dl, ECONNRESET);
					break;
				}

				//В assume something went wrong and we must resend
				json_mode = 1;
				req_len = 128;
				dl->offset = 0;
				time = k_uptime_get();

				sprintf(
					send_buf,
					"update_download={\"count\": %u, \"offset\": %u, \"size\": %u, \"progress\": %u}\n",
					MIN(128, (size_t)dl->file_size - dl->progress),
					dl->progress,
					dl->file_size,
					(dl->progress * 100) / dl->file_size
				);

				fota_send(send_buf, strlen(send_buf));
			}

			continue;
		}

		if (json_mode)
		{
			struct upload_data upload;
			size_t json_len;
			int i;
			const char upload_cmd[] = "update_upload=";

			char * end = strstr(dl->buf, "}");

			if (!end)
			{
				continue;
			}

			// line break
			end[1] = 0;

			// TODO what if we have two character line break
			json_len = strlen(dl->buf);

			int res = memcmp(upload_cmd, dl->buf, sizeof(upload_cmd) - 1);

			if (0 == res)
			{
				res = json_obj_parse(
					dl->buf + sizeof(upload_cmd) - 1,
					len,
					upload_descr,
					3,
					&upload
				);

				if (7 == res)
				{
					if (upload.offset != dl->progress)
					{
						// not the packet we expected;
						continue;
					}

					for (i = 0; 20 != i; ++i)
					{
						check[i] = strtou8(&upload.checksum[2 * i]);
					}

					req_len = upload.count;

					if (json_len + 1 < len)
					{
						// we have already received payload
						memmove(dl->buf, dl->buf + json_len + 1, len - json_len - 1);
						dl->offset = len - json_len - 1;
						req_len -= dl->offset;
					}

					json_mode = 0;
					mbedtls_sha1_free(&ctx_packet);
					mbedtls_sha1_init(&ctx_packet);
					mbedtls_sha1_starts(&ctx_packet);
				}
			}
		}
		else
		{
			dl->offset += len;

			if (dl->offset < req_len)
			{
				continue;
			}

			//LOG_DBG("Read %d bytes from uart", len);

			//dl->offset = len;

			mbedtls_sha1_update(&ctx_packet, dl->buf, dl->offset);
			rc = mbedtls_sha1_finish(&ctx_packet, sha1_computed);

			if (rc || memcmp(check, sha1_computed, 20))
			{
				// checksum does not match
				k_msleep(1000);
				time = k_uptime_get();
				json_mode = 1;
				req_len = 128;
				zero_counter = 0;
				dl->offset = 0;

				LOG_WRN("SHA1 of chunk failed.");

				// flush input buffer
				fota_recv(NULL, 0, 0, 1);

				sprintf(
					send_buf,
					"update_download={\"count\": %u, \"offset\": %u, \"size\": %u, \"progress\": %u}\n",
					MIN(128, (size_t)dl->file_size - dl->progress),
					dl->progress,
					dl->file_size,
					(dl->progress * 100) / dl->file_size
				);

				fota_send(send_buf, strlen(send_buf));

				continue;
			}

			dl->progress += dl->offset;

			/* Send fragment to application.
			 * If the application callback returns non-zero, stop.
			 */
			mbedtls_sha1_update(&ctx1, dl->buf, dl->offset);

			if (dl->progress == dl->file_size)
			{
				rc = mbedtls_sha1_finish(&ctx1, sha1_computed);

				if (0 == rc)
				{
					rc = memcmp(sha1_computed, sha1_expected, 20);
				}

				if (0 != rc)
				{
					// SHA1 failed
					fota_send("update_status={\"status\": \"checksum-invalid\"}\n", 45);
					error_evt_send(dl, EINVAL);

					break;
				}
			}

			rc = fragment_evt_send(dl);

			if (rc)
			{
				/* Restart and suspend */
				LOG_INF("Fragment refused, download stopped.");

				break;
			}

			if (dl->progress == dl->file_size)
			{
				LOG_INF("Download complete");

				const struct download_client_evt evt =
				{
					.id = DOWNLOAD_CLIENT_EVT_DONE,
				};

				fota_send("update_status={\"status\": \"checksum-valid\"}\n", 43);
				fota_send("update_status={\"status\": \"restarting\"}\n", 39);
				fota_update_notify();
				dl->callback(&evt);

				/* Restart and suspend */
				break;
			}
			else
			{
				// flush input
				fota_recv(NULL, 0, 0, 1);

				time = k_uptime_get();
				json_mode = 1;
				req_len = 128;
				zero_counter = 0;
				dl->offset = 0;

				sprintf(
					send_buf,
					"update_download={\"count\": %u, \"offset\": %u, \"size\": %u, \"progress\": %u}\n",
					MIN(128, (size_t)dl->file_size - dl->progress),
					dl->progress,
					dl->file_size,
					(dl->progress * 100) / dl->file_size
				);

				fota_send(send_buf, strlen(send_buf));
			}
		}
	}

	ff();

	/* Do not let the thread return, since it can't be restarted */
	goto restart_and_suspend;
}

void fota_uart_init(fota_recv_t fota_recv, fota_send_t fota_send)
{
	callback = fota_dl_handler;
	udc.fd = -1;
	udc.callback = download_client_callback;

	/* The thread is spawned now, but it will suspend itself;
	 * it is resumed when the download is started via the API.
	 */
	udc.tid = k_thread_create(
		&udc.thread,
		udc.thread_stack,
		K_THREAD_STACK_SIZEOF(udc.thread_stack),
		uart_download_thread,
		&udc,
		fota_recv,
		fota_send,
		0, /* prio */
		0,
		K_NO_WAIT
	);
}

void fota_uart_start(size_t file_size, uint8_t sha1[20], fota_finish_t fota_finish)
{
	udc.file_size = file_size;
	memcpy(sha1_expected, sha1, 20);
	ff = fota_finish;
	k_thread_resume(udc.tid);
}
/*************************** END FOTA ************************/
```
