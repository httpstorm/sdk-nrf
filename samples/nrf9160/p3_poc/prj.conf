## CMakeLists.txt
```
#
# Copyright (c) 2018 Nordic Semiconductor
#
# SPDX-License-Identifier: LicenseRef-BSD-5-Clause-Nordic
#

cmake_minimum_required(VERSION 3.8.2)

find_package(Zephyr REQUIRED HINTS $ENV{ZEPHYR_BASE})
project(protec3_mqtt_poc)

target_sources(app PRIVATE src/main.c)
target_sources(app PRIVATE src/buzzer.c)
target_sources(app PRIVATE src/uart.c)
target_sources(app PRIVATE src/apn.c)
target_sources(app PRIVATE src/fota_update.c)
target_sources(app PRIVATE src/drivers/shtc3.c)

zephyr_include_directories(src/include)
```

## sample.yaml
```
sample:
  name: mqtt simple sample
tests:
  samples.nrf9160.mqtt_simple:
    build_only: true
    build_on_all: true
    platform_allow: protec3_nrf9160_ns
    platform_whitelist: protec3_nrf9160_ns
    integration_platforms:
      - protec3_nrf9160_ns
    tags: ci_build
```

## prj.conf
```kconfig
#
# Copyright (c) 2020 Nordic Semiconductor ASA
#
# SPDX-License-Identifier: LicenseRef-Nordic-5-Clause
#
# General config
CONFIG_LOG=y
CONFIG_LOG_DEFAULT_LEVEL=3
CONFIG_STACK_SENTINEL=y
CONFIG_NEWLIB_LIBC=y
CONFIG_NEWLIB_LIBC_FLOAT_PRINTF=y
CONFIG_RING_BUFFER=y

# Segger RTT
CONFIG_USE_SEGGER_RTT=y
CONFIG_RTT_CONSOLE=y
CONFIG_UART_CONSOLE=y
CONFIG_LOG_BACKEND_RTT=y
CONFIG_LOG_BACKEND_UART=n

# Network
CONFIG_NETWORKING=y
CONFIG_NET_SOCKETS=y
CONFIG_NET_NATIVE=n

# Modem library
CONFIG_NRF_MODEM_LIB=y
# Align the max FD entry to NRF_MODEM_MAX_SOCKET_COUNT(8)
CONFIG_POSIX_MAX_FDS=8
# Enable below for modem trace
#CONFIG_NRF_MODEM_LIB_TRACE=y
# Handle modem fault
CONFIG_NRF_MODEM_LIB_ON_FAULT_APPLICATION_SPECIFIC=y

# Use GPIO
CONFIG_GPIO=y
CONFIG_GPIO_NRFX=y

# UART interface
CONFIG_SERIAL=y
CONFIG_UART_ASYNC_API=y
CONFIG_NRFX_TIMER2=y

# Stacks and heaps
CONFIG_MAIN_STACK_SIZE=8192
CONFIG_HEAP_MEM_POOL_SIZE=16384
CONFIG_SYSTEM_WORKQUEUE_STACK_SIZE=4096
CONFIG_AT_MONITOR_HEAP_SIZE=4096

# Device power management
CONFIG_PM_DEVICE=y

# FOTA
CONFIG_HTTP_PARSER_URL=y
CONFIG_FOTA_DOWNLOAD=y
CONFIG_FOTA_DOWNLOAD_PROGRESS_EVT=y
CONFIG_DFU_TARGET=y
CONFIG_DOWNLOAD_CLIENT=y
CONFIG_DOWNLOAD_CLIENT_STACK_SIZE=4096
CONFIG_BOOTLOADER_MCUBOOT=y
CONFIG_IMG_MANAGER=y

# FLASH
CONFIG_FLASH=y
CONFIG_FLASH_PAGE_LAYOUT=y
CONFIG_FLASH_MAP=y
CONFIG_STREAM_FLASH=y
CONFIG_MPU_ALLOW_FLASH_WRITE=y
CONFIG_IMG_ERASE_PROGRESSIVELY=y

# Settings
CONFIG_SETTINGS=y
CONFIG_SETTINGS_FCB=y
CONFIG_FCB=y

# nRF Cloud
#CONFIG_NRF_CLOUD_IPV6=y
CONFIG_NRF_CLOUD_MQTT=y
CONFIG_NRF_CLOUD_FOTA=n
CONFIG_NRF_CLOUD_AGPS=y
CONFIG_NRF_CLOUD_AGPS_FILTERED=n
CONFIG_NRF_CLOUD_PGPS=y
CONFIG_NRF_CLOUD_LOCATION=y
CONFIG_NRF_CLOUD_LOG_LEVEL_INF=y
CONFIG_NRF_CLOUD_GPS_LOG_LEVEL_INF=y
CONFIG_DATE_TIME=y
CONFIG_MODEM_INFO=y
CONFIG_MODEM_INFO_ADD_DATE_TIME=n
CONFIG_AT_MONITOR=y
CONFIG_MODEM_JWT=y
CONFIG_NRF_CLOUD_CLIENT_ID_SRC_INTERNAL_UUID=y



#
# Copyright (c) 2019 Nordic Semiconductor ASA
#
# SPDX-License-Identifier: LicenseRef-BSD-5-Clause-Nordic
#

# General config
CONFIG_ASSERT=y
CONFIG_HWINFO=y
CONFIG_REBOOT=y
CONFIG_NCS_SAMPLES_DEFAULTS=y

# Console
CONFIG_CONSOLE_SUBSYS=y
CONFIG_CONSOLE_HANDLER=y
CONFIG_CONSOLE_GETCHAR=y

# My config
CONFIG_UART_INTERRUPT_DRIVEN=y

# PWM for the buzzer
CONFIG_PWM=y

# Drivers
CONFIG_SENSOR=y
CONFIG_EEPROM=y
CONFIG_EEPROM_AT24=y

# Network
CONFIG_NET_SOCKETS_OFFLOAD=y
CONFIG_NET_SOCKETS_POSIX_NAMES=y

# LTE link control
CONFIG_LTE_LINK_CONTROL=y
CONFIG_LTE_AUTO_INIT_AND_CONNECT=n

CONFIG_LTE_NETWORK_MODE_NBIOT=y
CONFIG_LTE_NETWORK_MODE_LTE_M=n
CONFIG_LTE_NETWORK_USE_FALLBACK=n

CONFIG_LTE_PSM_REQ_RPTAU="00000110"
CONFIG_LTE_PSM_REQ_RAT="00000010"

CONFIG_MODEM_KEY_MGMT=y
CONFIG_NORDIC_SECURITY_BACKEND=y
#CONFIG_NRF_MODEM_LIB_SYS_INIT=n

# AT Host
CONFIG_AT_HOST_LIBRARY=y
CONFIG_AT_CMD_PARSER=y
#-CONFIG_AT_CMD_RESPONSE_MAX_LEN=4096

# JSON
CONFIG_JSON_LIBRARY=y

# MQTT
CONFIG_MQTT_LIB=y
CONFIG_MQTT_LIB_TLS=y

# Stacks and heaps
CONFIG_HW_STACK_PROTECTION=y

# Fatal error
CONFIG_RESET_ON_FATAL_ERROR=y
CONFIG_WATCHDOG=n

# Appliaction
CONFIG_MQTT_CLIENT_USERNAME="protec3.io"
CONFIG_MQTT_CLIENT_PASSWORD="kR59Tq72d%.SX}4aze!^1KX_+nJBRy&T"
#CONFIG_UPDATE_HOST="protec3.io:888"
#CONFIG_UPDATE_FILE="/update/app_update.bin"
#CONFIG_UPDATE_VERSION=1
#CONFIG_UPDATE_USE_HTTPS=n

# Image manager
CONFIG_MCUBOOT_IMG_MANAGER=y
```

## src/fota_update.c
```c
/*
 * Copyright (c) 2016 Open-RnD Sp. z o.o.
 * Copyright (c) 2020 Nordic Semiconductor ASA
 *
 * SPDX-License-Identifier: Apache-2.0
 */

#include <zephyr/kernel.h>
#include <stdio.h>
#include <zephyr/device.h>
#include <inttypes.h>
#include <string.h>
#include <zephyr/sys/util.h>
#include <zephyr/sys/printk.h>
#include <zephyr/drivers/gpio.h>
#include <zephyr/drivers/uart.h>
#include <zephyr/drivers/i2c.h>
#include <zephyr/drivers/eeprom.h>
#include <zephyr/drivers/sensor.h>
#include <modem/modem_info.h>
#include <modem/lte_lc.h>
//-#include <modem/at_cmd.h>
#include <zephyr/net/socket.h>
//?#include <nrf_socket.h>
#include <zephyr/sys/reboot.h>

//#include <adp536x-mod.h>
//#include <buzzer.h>

#include <errno.h>

/***************** FOTA ****************/
#include <zephyr/logging/log.h>
#include <zephyr/dfu/mcuboot.h>
#include <zephyr/data/json.h>
#include <dfu/dfu_target.h>
#include <net/download_client.h>
#include <net/fota_download.h>
#include <pm_config.h>
#include <mbedtls/sha1.h>
#include "fota_update.h"
/***************** END FOTA ***********/


#define OK 0
#define FAIL -1

#ifndef CONFIG_UPDATE_HOST
# define CONFIG_UPDATE_HOST "protec3.io:888"
#endif

#ifndef CONFIG_UPDATE_FILE
# define CONFIG_UPDATE_FILE "/update/app_update.bin"
#endif

//#define CONFIG_USE_HTTPS

/************************ FOTA ***********************/
LOG_MODULE_REGISTER(fota_update, CONFIG_FOTA_DOWNLOAD_LOG_LEVEL);

static struct download_client udc;
static fota_download_callback_t callback;
//static bl_sha256_ctx_t ctx256;
static mbedtls_sha1_context ctx1;
static mbedtls_sha1_context ctx_packet;
static uint8_t sha1_expected[20];
static fota_finish_t ff;

struct upload_data
{
	int offset;
	int count;
	const char * checksum;
};

struct json_obj_descr upload_descr[] =
{
	JSON_OBJ_DESCR_PRIM(struct upload_data, offset, JSON_TOK_NUMBER),
	JSON_OBJ_DESCR_PRIM(struct upload_data, count, JSON_TOK_NUMBER),
	JSON_OBJ_DESCR_PRIM(struct upload_data, checksum, JSON_TOK_STRING)
};

static void fota_dl_handler(const struct fota_download_evt * evt)
{
	volatile int stop = 1;

	switch (evt->id)
	{
	case FOTA_DOWNLOAD_EVT_ERROR:
		printk("Received error from fota_download\n");
#if 0
		printk("Restartng...\n");
		sys_reboot(SYS_REBOOT_WARM);

		while (stop);
#endif

		break;

	case FOTA_DOWNLOAD_EVT_FINISHED:
		printk("FOTA download succeeded\n\r");
		printk("Restartng...\n");
		//?boot_request_upgrade(BOOT_UPGRADE_PERMANENT);
		sys_reboot(SYS_REBOOT_WARM);

		while (stop);

		break;

	default:
		break;
	}
}

void fota_dl_init(void)
{
	//k_work_init(&fota_work, app_dfu_transfer_start);
	int err = fota_download_init(fota_dl_handler);

	if (0 != err)
	{
		printf("fota init failed %i\n\r", err);
		return;
	}

	//printk("FIRMWARE VERSION 2\n");
}

void fota_dl_trigger(void)
{
	int retval;
	int sec_tag;
	//-char * apn = NULL;

	printk("FOTA\n");

#ifndef CONFIG_USE_HTTPS
	sec_tag = -1;
#else
	sec_tag = CONFIG_SEC_TAG;
#endif

	retval = fota_download_start(
		CONFIG_UPDATE_HOST,
		CONFIG_UPDATE_FILE,
		sec_tag,
		0/*apn*/,
		0
	);

	if (retval != 0)
	{
		/* Re-enable button callback */
		printk("fota_download_start() failed, err %d\n", -retval);
	}

}

static void send_evt(enum fota_download_evt_id id)
{
	__ASSERT(id != FOTA_DOWNLOAD_EVT_PROGRESS, "use send_progress");
	__ASSERT(id != FOTA_DOWNLOAD_EVT_ERROR, "use send_error_evt");

	const struct fota_download_evt evt =
	{
		.id = id
	};

	callback(&evt);
}

static void send_error_evt(enum fota_download_error_cause cause)
{
	__ASSERT(cause != FOTA_DOWNLOAD_ERROR_CAUSE_NO_ERROR, "use a valid error cause");

	const struct fota_download_evt evt =
	{
		.id = FOTA_DOWNLOAD_EVT_ERROR,
		.cause = cause
	};

	callback(&evt);
}

static void send_progress(int progress)
{
#ifdef CONFIG_FOTA_DOWNLOAD_PROGRESS_EVT
	const struct fota_download_evt evt =
	{
		.id = FOTA_DOWNLOAD_EVT_PROGRESS,
		.progress = progress
	};

	callback(&evt);
#endif
}

static void dfu_target_callback_handler(enum dfu_target_evt_id evt)
{
	switch (evt)
	{
	case DFU_TARGET_EVT_TIMEOUT:
		send_evt(FOTA_DOWNLOAD_EVT_ERASE_PENDING);
		break;

	case DFU_TARGET_EVT_ERASE_DONE:
		send_evt(FOTA_DOWNLOAD_EVT_ERASE_DONE);
		break;

	default:
		send_error_evt(FOTA_DOWNLOAD_ERROR_CAUSE_DOWNLOAD_FAILED);
	}
}

static int download_client_callback(const struct download_client_evt * event)
{
	static bool first_fragment = true;
	static size_t file_size;
	size_t offset;
	int err;

	if (event == NULL)
	{
		return -EINVAL;
	}

	switch (event->id)
	{
	case DOWNLOAD_CLIENT_EVT_FRAGMENT:
	{
		if (first_fragment)
		{
			err = download_client_file_size_get(&udc, &file_size);

			if (err != 0)
			{
				LOG_DBG("download_client_file_size_get err: %d", err);
				send_error_evt(FOTA_DOWNLOAD_ERROR_CAUSE_DOWNLOAD_FAILED);
				return err;
			}

			first_fragment = false;
			int img_type = dfu_target_img_type(event->fragment.buf, event->fragment.len);
			//-err = dfu_target_init(img_type, file_size, dfu_target_callback_handler);
			err = dfu_target_init(img_type, 0, file_size, dfu_target_callback_handler);

			if ((err < 0) && (err != -EBUSY))
			{
				LOG_ERR("dfu_target_init error %d", err);
				send_error_evt(FOTA_DOWNLOAD_ERROR_CAUSE_DOWNLOAD_FAILED);
				int res = dfu_target_reset();

				if (res != 0)
				{
					LOG_ERR("Unable to reset DFU target");
				}

				first_fragment = true;

				return err;
			}
		}

		err = dfu_target_write(event->fragment.buf, event->fragment.len);

		if (err != 0)
		{
			LOG_ERR("dfu_target_write error %d", err);
			int res = dfu_target_done(false);

			if (res != 0)
			{
				LOG_ERR("Unable to free DFU target resources");
			}

			first_fragment = true;
			send_error_evt(FOTA_DOWNLOAD_ERROR_CAUSE_INVALID_UPDATE);

			return err;
		}

		if (IS_ENABLED(CONFIG_FOTA_DOWNLOAD_PROGRESS_EVT) && !first_fragment)
		{
			err = dfu_target_offset_get(&offset);

			if (err != 0)
			{
				LOG_DBG("unable to get dfu target offset err: %d", err);
				send_error_evt(FOTA_DOWNLOAD_ERROR_CAUSE_DOWNLOAD_FAILED);

				return err;
			}

			if (file_size == 0)
			{
				LOG_DBG("invalid file size: %d", file_size);
				send_error_evt(FOTA_DOWNLOAD_ERROR_CAUSE_DOWNLOAD_FAILED);

				return err;
			}

			send_progress((offset * 100) / file_size);
			LOG_DBG("Progress: %d/%d%%", offset, file_size);
		}

		break;
	}

	case DOWNLOAD_CLIENT_EVT_DONE:
		err = dfu_target_done(true);

		if (err != 0)
		{
			LOG_ERR("dfu_target_done error: %d", err);
			send_error_evt(FOTA_DOWNLOAD_ERROR_CAUSE_DOWNLOAD_FAILED);

			return err;
		}

		send_evt(FOTA_DOWNLOAD_EVT_FINISHED);
		first_fragment = true;

		break;

	case DOWNLOAD_CLIENT_EVT_ERROR:
	{
		/* In case of socket errors we can return 0 to retry/continue,
		 * or non-zero to stop
		 */
		LOG_ERR("Download client error");
		err = dfu_target_done(false);

		if (err == -EACCES)
		{
			LOG_DBG("No DFU target was initialized");
		}
		else if (err != 0)
		{
			LOG_ERR("Unable to deinitialze resources used by dfu_target.");
		}

		first_fragment = true;
		send_error_evt(FOTA_DOWNLOAD_ERROR_CAUSE_DOWNLOAD_FAILED);

		/* Return non-zero to tell download_client to stop */
		return event->error;
	}

	default:
		break;
	}

	return 0;
}



static int fragment_evt_send(const struct download_client * client)
{
	__ASSERT(client->offset <= CONFIG_DOWNLOAD_CLIENT_BUF_SIZE, "Buffer overflow!");

	const struct download_client_evt evt =
	{
		.id = DOWNLOAD_CLIENT_EVT_FRAGMENT,
		.fragment =
		{
			.buf = client->buf,
			.len = client->offset,
		}
	};

	return client->callback(&evt);
}

static int error_evt_send(const struct download_client * dl, int error)
{
	/* Error will be sent as negative. */
	__ASSERT_NO_MSG(error > 0);

	const struct download_client_evt evt =
	{
		.id = DOWNLOAD_CLIENT_EVT_ERROR,
		.error = -error
	};

	return dl->callback(&evt);
}

void uart_download_thread(void * client, void * recv_func, void * send_func)
{
	int64_t time;
	int rc = 0;
	int zero_counter;
	size_t len, req_len;
	char send_buf[128];
	uint8_t check[20];
	uint8_t sha1_computed[20];
	int json_mode;
	struct download_client * const dl = client;
	fota_recv_t fota_recv = recv_func;
	fota_send_t fota_send = send_func;

restart_and_suspend:
	k_thread_suspend(dl->tid);
	mbedtls_sha1_free(&ctx1);
	mbedtls_sha1_init(&ctx1);
	mbedtls_sha1_starts(&ctx1);

	//fota_recv(dl->buf, sizeof(dl->buf), 0, 0);

	time = k_uptime_get();
	json_mode = 1;
	dl->offset = 0;
	dl->progress = 0;
	zero_counter = 0;
	req_len = 128;
	fota_send("update_status={\"status\": \"download-image\"}\n", 43);

	// update_download={"count": 128, "offset": 0, "size": 196358, "progress": 72}
	sprintf(
		send_buf,
		"update_download={\"count\": %u, \"offset\": %u, \"size\": %u, \"progress\": %u}\n",
		MIN(128, (size_t)dl->file_size),
		dl->progress,
		dl->file_size,
		(dl->progress * 100) / dl->file_size
	);

	fota_send(send_buf, strlen(send_buf));

	while (true)
	{
#if 0
		__ASSERT(dl->offset < sizeof(dl->buf), "Buffer overflow");

		if (sizeof(dl->buf) - dl->offset == 0)
		{
			LOG_ERR("Buffer not sufficient (> %d)", sizeof(dl->buf));
			error_evt_send(dl, E2BIG);

			break;
		}

		LOG_DBG(
			"Receiving up to %d bytes at %p...",
			sizeof(dl->buf) - dl->offset,
			dl->buf + dl->offset
		);

#endif

		/*
		len = uart_fifo_read(
			(const struct device*)dl->host,
			dl->buf,
			MIN(sizeof(dl->buf), dl->file_size - dl->progress)
		);
		*/
		len = fota_recv(dl->buf + dl->offset, MIN(sizeof(dl->buf), req_len - dl->offset), json_mode, 0);

		/*len = recv(dl->fd, dl->buf + dl->offset, sizeof(dl->buf) - dl->offset, 0);*/

		if (len == -1)
		{
			/* We just had an unexpected socket error or closure */

			/* If there is a partial data payload in our buffer,
			 * and it has been accounted in our progress, we have
			 * to hand it to the application before discarding it.
			 */

			LOG_ERR("Error in fgets");

			/* Notify the application of the error via en event.
			 * Attempt to reconnect and resume the download
			 * if the application returns Zero via the event.
			 */
			rc = error_evt_send(dl, ECONNRESET);

			if (rc)
			{
				/* Restart and suspend */
				break;
			}

			dl->offset = 0;
			zero_counter = 0;
			continue;
		}

		if (0 == len)
		{
			// more than 1000 ms passed?
			if (k_uptime_get() - time > 1000)
			{
				++zero_counter;

				if (10 <= zero_counter)
				{
					// more than 10 s passed, assume connection is down
					LOG_WRN("No data for 10 s!\n");
					error_evt_send(dl, ECONNRESET);
					break;
				}

				//В assume something went wrong and we must resend
				json_mode = 1;
				req_len = 128;
				dl->offset = 0;
				time = k_uptime_get();

				sprintf(
					send_buf,
					"update_download={\"count\": %u, \"offset\": %u, \"size\": %u, \"progress\": %u}\n",
					MIN(128, (size_t)dl->file_size - dl->progress),
					dl->progress,
					dl->file_size,
					(dl->progress * 100) / dl->file_size
				);

				fota_send(send_buf, strlen(send_buf));
			}

			continue;
		}

		if (json_mode)
		{
			struct upload_data upload;
			size_t json_len;
			int i;
			const char upload_cmd[] = "update_upload=";

			char * end = strstr(dl->buf, "}");

			if (!end)
			{
				continue;
			}

			// line break
			end[1] = 0;

			// TODO what if we have two character line break
			json_len = strlen(dl->buf);

			int res = memcmp(upload_cmd, dl->buf, sizeof(upload_cmd) - 1);

			if (0 == res)
			{
				res = json_obj_parse(
					dl->buf + sizeof(upload_cmd) - 1,
					len,
					upload_descr,
					3,
					&upload
				);

				if (7 == res)
				{
					if (upload.offset != dl->progress)
					{
						// not the packet we expected;
						continue;
					}

					for (i = 0; 20 != i; ++i)
					{
						check[i] = strtou8(&upload.checksum[2 * i]);
					}

					req_len = upload.count;

					if (json_len + 1 < len)
					{
						// we have already received payload
						memmove(dl->buf, dl->buf + json_len + 1, len - json_len - 1);
						dl->offset = len - json_len - 1;
						req_len -= dl->offset;
					}

					json_mode = 0;
					mbedtls_sha1_free(&ctx_packet);
					mbedtls_sha1_init(&ctx_packet);
					mbedtls_sha1_starts(&ctx_packet);
				}
			}
		}
		else
		{
			dl->offset += len;

			if (dl->offset < req_len)
			{
				continue;
			}

			//LOG_DBG("Read %d bytes from uart", len);

			//dl->offset = len;

			mbedtls_sha1_update(&ctx_packet, dl->buf, dl->offset);
			rc = mbedtls_sha1_finish(&ctx_packet, sha1_computed);

			if (rc || memcmp(check, sha1_computed, 20))
			{
				// checksum does not match
				k_msleep(1000);
				time = k_uptime_get();
				json_mode = 1;
				req_len = 128;
				zero_counter = 0;
				dl->offset = 0;

				LOG_WRN("SHA1 of chunk failed.");

				// flush input buffer
				fota_recv(NULL, 0, 0, 1);

				sprintf(
					send_buf,
					"update_download={\"count\": %u, \"offset\": %u, \"size\": %u, \"progress\": %u}\n",
					MIN(128, (size_t)dl->file_size - dl->progress),
					dl->progress,
					dl->file_size,
					(dl->progress * 100) / dl->file_size
				);

				fota_send(send_buf, strlen(send_buf));

				continue;
			}

			dl->progress += dl->offset;

			/* Send fragment to application.
			 * If the application callback returns non-zero, stop.
			 */
			mbedtls_sha1_update(&ctx1, dl->buf, dl->offset);

			if (dl->progress == dl->file_size)
			{
				rc = mbedtls_sha1_finish(&ctx1, sha1_computed);

				if (0 == rc)
				{
					rc = memcmp(sha1_computed, sha1_expected, 20);
				}

				if (0 != rc)
				{
					// SHA1 failed
					fota_send("update_status={\"status\": \"checksum-invalid\"}\n", 45);
					error_evt_send(dl, EINVAL);

					break;
				}
			}

			rc = fragment_evt_send(dl);

			if (rc)
			{
				/* Restart and suspend */
				LOG_INF("Fragment refused, download stopped.");

				break;
			}

			if (dl->progress == dl->file_size)
			{
				LOG_INF("Download complete");

				const struct download_client_evt evt =
				{
					.id = DOWNLOAD_CLIENT_EVT_DONE,
				};

				fota_send("update_status={\"status\": \"checksum-valid\"}\n", 43);
				fota_send("update_status={\"status\": \"restarting\"}\n", 39);
				fota_update_notify();
				dl->callback(&evt);

				/* Restart and suspend */
				break;
			}
			else
			{
				// flush input
				fota_recv(NULL, 0, 0, 1);

				time = k_uptime_get();
				json_mode = 1;
				req_len = 128;
				zero_counter = 0;
				dl->offset = 0;

				sprintf(
					send_buf,
					"update_download={\"count\": %u, \"offset\": %u, \"size\": %u, \"progress\": %u}\n",
					MIN(128, (size_t)dl->file_size - dl->progress),
					dl->progress,
					dl->file_size,
					(dl->progress * 100) / dl->file_size
				);

				fota_send(send_buf, strlen(send_buf));
			}
		}
	}

	ff();

	/* Do not let the thread return, since it can't be restarted */
	goto restart_and_suspend;
}

void fota_uart_init(fota_recv_t fota_recv, fota_send_t fota_send)
{
	callback = fota_dl_handler;
	udc.fd = -1;
	udc.callback = download_client_callback;

	/* The thread is spawned now, but it will suspend itself;
	 * it is resumed when the download is started via the API.
	 */
	udc.tid = k_thread_create(
		&udc.thread,
		udc.thread_stack,
		K_THREAD_STACK_SIZEOF(udc.thread_stack),
		uart_download_thread,
		&udc,
		fota_recv,
		fota_send,
		0, /* prio */
		0,
		K_NO_WAIT
	);
}

void fota_uart_start(size_t file_size, uint8_t sha1[20], fota_finish_t fota_finish)
{
	udc.file_size = file_size;
	memcpy(sha1_expected, sha1, 20);
	ff = fota_finish;
	k_thread_resume(udc.tid);
}
/*************************** END FOTA ************************/
```

## src/uart.c
```c
/*
 * Copyright (c) 2018 Nordic Semiconductor ASA
 *
 * SPDX-License-Identifier: LicenseRef-BSD-5-Clause-Nordic
 */

#include <zephyr/kernel.h>
#include <stdio.h>
#include <ctype.h>
#include <zephyr/logging/log.h>
#include <zephyr/drivers/uart.h>
#include <string.h>
#include <zephyr/init.h>
#include <nrf_modem_at.h>
//-#include <modem/at_cmd.h>
//-#include <modem/at_notif.h>
#include <modem/at_monitor.h>
#include <modem/at_cmd_parser.h>
#include <modem/modem_slm.h>
#include <modem/lte_lc.h>
#include <zephyr/sys/reboot.h>

#include "uart.h"
#include "apn.h"
#include "fota_update.h"
#include "eeprom.h"

LOG_MODULE_REGISTER(my_uart, CONFIG_AT_HOST_LOG_LEVEL);

/* Stack definition for uart host workqueue */
#define UART_STACK_SIZE 1024

K_THREAD_STACK_DEFINE(uart_stack_area, UART_STACK_SIZE);
#define INVALID_DESCRIPTOR      -1

#define OK_STR    "OK\r\n"
#define ERROR_STR "ERROR\r\n"

#if CONFIG_AT_HOST_CMD_MAX_LEN > CONFIG_AT_CMD_RESPONSE_MAX_LEN
#define AT_BUF_SIZE CONFIG_AT_HOST_CMD_MAX_LEN
#else
#define AT_BUF_SIZE CONFIG_AT_CMD_RESPONSE_MAX_LEN
#endif

extern void modem_configure(void);

static const struct device * uart_device;
static char at_buf[AT_BUF_SIZE]; /* AT command and modem response buffer */
static struct k_work_q uart_work_q;
struct k_work uart_work;
static enum uart_modes uart_mode;
static bool inside_quotes;
static size_t at_cmd_len;
static int ptr = 0;
static int nl_ptr = 0;

char str[128];

const char update_cmd[] = "update=";
const char apn_get_cmd[] = "apn_get=";
const char apn_set_cmd[] = "apn_set=";

struct update_req
{
	int build;
	const char * checksum;
	const char * path;
	int size;
};

struct json_obj_descr update_req_descr[] =
{
	JSON_OBJ_DESCR_PRIM(struct update_req, build, JSON_TOK_NUMBER),
	JSON_OBJ_DESCR_PRIM(struct update_req, checksum, JSON_TOK_STRING),
	JSON_OBJ_DESCR_PRIM(struct update_req, path, JSON_TOK_STRING),
	JSON_OBJ_DESCR_PRIM(struct update_req, size, JSON_TOK_NUMBER)
};

uint8_t strtou8(const char * s)
{
	int i;
	uint8_t res = 0;

	for (i = 0; 2 != i; ++i)
	{
		res <<= 4;

		if (('0' <= *s) && ('9' >= *s))
		{
			res |= *s - '0';
		}
		else if (('a' <= *s) && ('f' >= *s))
		{
			res |= *s - 'a' + 10;
		}
		else
		{
			// assume upper case hex
			res |= *s - 'A' + 10;
		}

		s++;
	}

	return res;
}

int uart_fota_send(const uint8_t * buf, size_t len)
{
	printk("%s\n", buf);
	return strlen(buf);
}

int uart_fota_recv(uint8_t * buf, size_t len, int look_for_newline, int flush)
{
	size_t actual_len;

	if (flush)
	{
		ptr = 0;
		nl_ptr = 0;
		inside_quotes = false;
		at_cmd_len = 0;

		return 0;
	}

	if (look_for_newline)
	{
		memcpy(buf, at_buf, nl_ptr);
		return nl_ptr;
	}

	actual_len = MIN(len, at_cmd_len - ptr);

	memcpy(buf, at_buf + ptr, actual_len);
	ptr += actual_len;

	return actual_len;
}

void uart_fota_finish(void)
{
	uart_set_mode(CMD_MODE);
}

static inline void write_uart_string(const char * str)
{
	/* Send characters until, but not including, null */
	for (size_t i = 0; str[i]; i++)
	{
		uart_poll_out(uart_device, str[i]);
	}
}

void uart_worker(struct k_work * work)
{
	enum at_cmd_state state;
	int               err, res;
	size_t            len = strlen(at_buf);
	char              cmd_reset[] = "reset";
	//char              cmd_button[] = "button";

	ARG_UNUSED(work);

	if ((sizeof(cmd_reset) - 1) == len)
	{
		if (!memcmp(at_buf, cmd_reset, len))
		{
			LOG_INF("Reset board");
			sys_reboot(SYS_REBOOT_WARM);
		}
	}

	/*if ((sizeof(cmd_button) - 1) == len)
	{
		if (!memcmp(at_buf, cmd_button, len))
		{
			button_int();
		}
	}*/

	if ((len >= 2) && ('A' == at_buf[0]) && ('T' == at_buf[1]))
	{
		/* Assume we are dealing with an AT command */

		//-err = at_cmd_write(at_buf, at_buf, sizeof(at_buf), &state);
		err = nrf_modem_at_cmd(at_buf, sizeof(at_buf), "%s", at_buf);

		if (err < 0)
		{
			LOG_ERR("Error while processing AT command: %d", err);
			state = AT_CMD_ERROR;
		}

		/* Handle the various error responses from modem */
		switch (state)
		{
		case AT_CMD_OK:
			write_uart_string(at_buf);
			write_uart_string(OK_STR);
			break;

		case AT_CMD_ERROR:
			write_uart_string(ERROR_STR);
			break;

		case AT_CMD_ERROR_CMS:
			sprintf(str, "+CMS ERROR: %d\r\n", err);
			write_uart_string(str);
			break;

		case AT_CMD_ERROR_CME:
			sprintf(str, "+CME ERROR: %d\r\n", err);
			write_uart_string(str);
			break;

		default:
			break;
		}
	}
	else if (0 == memcmp(update_cmd, at_buf, sizeof(update_cmd) - 1))
	{
		struct update_req req;

		res = json_obj_parse(
			at_buf + sizeof(update_cmd) - 1,
			len,
			update_req_descr,
			4,
			&req
		);

		char check[20];

		// at least size (bit 3) and checksum (bit 1) must be present
		if ((0 < res) && ((0xA & res) == 0xA))
		{
			for (len = 0; 20 != len; ++len)
			{
				check[len] = strtou8(&req.checksum[2 * len]);
			}

			uart_set_mode(NEWLINE_MODE);
			uart_irq_rx_enable(uart_device);
			fota_uart_start(req.size, check, uart_fota_finish);
		}
	}
	else if (0 == memcmp(apn_get_cmd, at_buf, sizeof(apn_get_cmd) - 1))
	{
		apn_get(
			at_buf + sizeof(apn_get_cmd) - 1,
			len,
			&apn_config
		);
	}
	else if (0 == memcmp(apn_set_cmd, at_buf, sizeof(apn_set_cmd) - 1))
	{
		err = apn_set(at_buf + sizeof(apn_set_cmd) - 1, len, &apn_config);

		if (OK == err)
		{

			snprintf(
				str,
				sizeof(str),
				"apn_eeprom={\"select\": %d, \"APN\": \"%s\"}\n",
				apn_config.select,
				apn_config.APN
			);

			uart_fota_send(str, strlen(str));
			lte_lc_power_off();
			lte_lc_deinit();
			modem_configure();
		}
	}

	uart_irq_rx_enable(uart_device);
}

static void uart_rx_handler(uint8_t character)
{
	if (RAW_MODE == uart_mode)
	{
		at_buf[at_cmd_len] = character;
		at_cmd_len++;
		return;
	}

	if (NEWLINE_MODE == uart_mode)
	{
		if ((!nl_ptr) && (('\r' == character) || ('\n' == character)))
		{
			nl_ptr = at_cmd_len;
			ptr = at_cmd_len;
		}
		else
		{
			at_buf[at_cmd_len] = character;
			at_cmd_len++;
		}

		return;
	}

	/* Handle control characters */
	switch (character)
	{
	case 0x08: /* Backspace. */
		/* Fall through. */
	case 0x7F: /* DEL character */
		if (at_cmd_len > 0)
		{
			at_cmd_len--;
		}

		return;
	}

	/* Handle termination characters, if outside quotes. */
	if (!inside_quotes)
	{
		if (('\r' == character) || ('\n' == character))
		{
			goto send;
		}
	}

	/* Detect AT command buffer overflow, leaving space for null */
	if (at_cmd_len + 1 > sizeof(at_buf) - 1)
	{
		LOG_ERR("Buffer overflow, dropping '%c'\n", character);
		return;
	}

	/* Write character to AT buffer */
	at_buf[at_cmd_len] = character;
	at_cmd_len++;

	/* Handle special written character */
	if (character == '"')
	{
		inside_quotes = !inside_quotes;
	}

	return;

send:
	/* Terminate the command string */
	at_buf[at_cmd_len] = '\0';

	/* Reset UART handler state */
	inside_quotes = false;
	at_cmd_len = 0;

	/* Check for the presence of one printable non-whitespace character */
	for (const char * c = at_buf;; c++)
	{
		if (*c > ' ')
		{
			break;
		}
		else if (*c == '\0')
		{
			/* Drop command, if it has no such character */
			return;
		}
	}

	/* Send the command, if there is one to send */
	if (at_buf[0])
	{
		uart_irq_rx_disable(uart_device); /* Stop UART to protect at_buf */
		k_work_submit_to_queue(&uart_work_q, &uart_work);
	}
}

void my_uart_isr(const struct device * dev, void * data)
{
	uint8_t character;

	uart_irq_update(dev);

	if (!uart_irq_rx_ready(dev))
	{
		return;
	}

	/*
	 * Check that we are not sending data (buffer must be preserved then),
	 * and that a new character is available before handling each character
	 */
	while (
		(!k_work_is_pending(&uart_work)) &&
		(uart_fifo_read(dev, &character, 1))
		)
	{
		uart_rx_handler(character);
	}
}

void my_uart_init(const struct device * uart_dev)
{
	uart_device = uart_dev;
	uart_mode = CMD_MODE;
	inside_quotes = false;
	uart_irq_callback_set(uart_dev, my_uart_isr);
	uart_irq_rx_enable(uart_dev);
	k_work_init(&uart_work, uart_worker);

	k_work_queue_start(
		&uart_work_q,
		uart_stack_area,
		K_THREAD_STACK_SIZEOF(uart_stack_area),
		CONFIG_AT_HOST_THREAD_PRIO,
		NULL
	);
}

void uart_set_mode(enum uart_modes mode)
{
	uart_mode = mode;
	inside_quotes = false;
	ptr = 0;
	nl_ptr = 0;
	at_cmd_len = 0;
}
```
