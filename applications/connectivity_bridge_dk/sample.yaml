## applications/connectivity_bridge_dk/sample.yaml
```yaml
sample:
  description: Connectivity Bridge application
  name: Connectivity Bridge
tests:
  applications.connectivity_bridge:
    build_only: true
    platform_allow: nrf9160dk_nrf52840
    integration_platforms:
      - nrf9160dk_nrf52840
    tags: ci_build
```

## applications/connectivity_bridge_g/boards/nrf52840dk_nrf52840.conf
```kconfig
# General
CONFIG_BOOTLOADER_MCUBOOT=n
CONFIG_BRIDGE_BUF_SIZE=2048

# USB
CONFIG_USB_DEVICE_STACK=y
CONFIG_USB_DEVICE_REMOTE_WAKEUP=n
CONFIG_USB_DEVICE_MANUFACTURER="Nordic Semiconductor"
CONFIG_USB_DEVICE_PRODUCT="nrf52840dk UART"
CONFIG_USB_DEVICE_VID=0x1915
CONFIG_USB_DEVICE_PID=0x9100
CONFIG_USB_DEVICE_SN="THINGY91 12PLACEHLDRS" # This is overridden at runtime
CONFIG_USB_COMPOSITE_DEVICE=y
CONFIG_USB_CDC_ACM_RINGBUF_SIZE=16384

# Disk and file system
CONFIG_DISK_ACCESS=y
CONFIG_DISK_DRIVER_RAM=y
CONFIG_DISK_RAM_VOLUME_SIZE=64
CONFIG_FILE_SYSTEM=y
CONFIG_FAT_FILESYSTEM_ELM=y
CONFIG_FS_FATFS_LFN=y

# BLE
CONFIG_BT_DEVICE_NAME="nrf52840dk UART"
```

## applications/connectivity_bridge_g/boards/nrf9160dk_nrf52840.conf
```kconfig
# Features
CONFIG_BRIDGE_CDC_ENABLE=n
CONFIG_BRIDGE_MSC_ENABLE=n

# BLE
CONFIG_BT_DEVICE_NAME="nrf9160dk UART"
```

## applications/connectivity_bridge_g/sample.yaml
```yaml
sample:
  description: Connectivity Bridge application
  name: Connectivity Bridge
tests:
  applications.connectivity_bridge:
    build_only: true
    platform_allow: nrf52840dk_nrf52840 nrf9160dk_nrf52840 thingy91_nrf52840
    integration_platforms:
      - nrf52840dk_nrf52840
      - nrf9160dk_nrf52840
      - thingy91_nrf52840
    tags: ci_build
```

## boards/arm/protec3_nrf52840/Kconfig.board
```kconfig
# nRF52840 PROTEC3 board configuration
#
# Copyright (c) 2019 Nordic Semiconductor ASA
#
# SPDX-License-Identifier: LicenseRef-Nordic-5-Clause

config BOARD_PROTEC3_NRF52840
	bool "nRF52840 PROTEC3"
	depends on SOC_NRF52840_QIAA
```

## boards/arm/protec3_nrf52840/Kconfig.defconfig
```kconfig
# nRF52840 PROTEC3 board configuration
#
# Copyright (c) 2019 Nordic Semiconductor ASA
#
# SPDX-License-Identifier: LicenseRef-Nordic-5-Clause

if BOARD_PROTEC3_NRF52840

config BOARD
	default "protec3_nrf52840"

if USB

config USB_NRFX
	def_bool y

config USB_DEVICE_STACK
	def_bool y

endif # USB

config HW_STACK_PROTECTION
	default ARCH_HAS_STACK_PROTECTION

endif # BOARD_PROTEC3_NRF52840
```

## boards/arm/protec3_nrf9160/Kconfig.board
```kconfig
# Protec3 nRF9160 board configuration
#
# Copyright (c) 2019 Nordic Semiconductor ASA
#
# SPDX-License-Identifier: LicenseRef-Nordic-5-Clause

if SOC_NRF9160_SICA

config BOARD_PROTEC3_NRF9160
	bool "nRF9160 PROTEC3"

config BOARD_PROTEC3_NRF9160_NS
	bool "nRF9160 PROTEC3 non-secure"

endif # SOC_NRF9160_SICA
```

## boards/arm/protec3_nrf9160/Kconfig.defconfig
```kconfig
# Thingy:91 nRF9160 board configuration
#
# Copyright (c) 2018 Nordic Semiconductor ASA
#
# SPDX-License-Identifier: LicenseRef-Nordic-5-Clause

if BOARD_PROTEC3_NRF9160 || BOARD_PROTEC3_NRF9160_NS

config BOARD
	default "protec3_nrf9160"

if ADC

config ADC_0
	bool
	default y

endif # ADC

#if I2C
#
#config I2C_2
#	bool
#	default y
#
#endif # I2C

if PWM

config PWM_0
	bool
	default y

endif # PWM

if SPI

config SPI_3
	bool
	default y

endif # SPI

# By default, if we build for a Non-Secure version of the board,
# enable building with TF-M as the Secure Execution Environment.
config BUILD_WITH_TFM
	default y if BOARD_PROTEC3_NRF9160_NS

if BUILD_WITH_TFM

# By default, if we build with TF-M, instruct build system to
# flash the combined TF-M (Secure) & Zephyr (Non Secure) image
config TFM_FLASH_MERGED_BINARY
	bool
	default y

endif # BUILD_WITH_TFM

# For the secure version of the board the firmware is linked at the beginning
# of the flash, or into the code-partition defined in DT if it is intended to
# be loaded by MCUboot. If the secure firmware is to be combined with a non-
# secure image (TRUSTED_EXECUTION_SECURE=y), the secure FW image shall always
# be restricted to the size of its code partition.
# For the non-secure version of the board, the firmware
# must be linked into the code-partition (non-secure) defined in DT, regardless.
# Apply this configuration below by setting the Kconfig symbols used by
# the linker according to the information extracted from DT partitions.

if BOARD_PROTEC3_NRF9160 && TRUSTED_EXECUTION_SECURE

config FLASH_LOAD_SIZE
	default $(dt_chosen_reg_size_hex,$(DT_CHOSEN_Z_CODE_PARTITION))

endif # BOARD_PROTEC3_NRF9160 && TRUSTED_EXECUTION_SECURE

if BOARD_PROTEC3_NRF9160_NS

config FLASH_LOAD_OFFSET
	default $(dt_chosen_reg_addr_hex,$(DT_CHOSEN_Z_CODE_PARTITION))

config FLASH_LOAD_SIZE
	default $(dt_chosen_reg_size_hex,$(DT_CHOSEN_Z_CODE_PARTITION))

endif # BOARD_PROTEC3_NRF9160_NS

config BT_HCI_VS
	default y if BT

config HW_STACK_PROTECTION
	default ARCH_HAS_STACK_PROTECTION

endif # BOARD_PROTEC3_NRF9160 || BOARD_PROTEC3_NRF9160_NS
```

## boards/arm/protec3_nrf9160/dts/bindings/nordic,protec3-nrf52840-reset.yaml
```yaml
# Copyright (c) 2021 Nordic Semiconductor ASA
# SPDX-License-Identifier: Apache-2.0

description: GPIO used to reset nRF52840 on Protec3

compatible: "nordic,protec3-nrf52840-reset"

include: base.yaml

properties:
  status:
    required: true

  gpios:
    type: phandle-array
    required: true
    description: |
      GPIO to use as nRF52840 reset line: output in nRF9160, input in nRF52840.
```

## samples/nrf9160/protec3_bridge/sample.yaml
```yaml
sample:
  description: Connectivity Bridge application
  name: Connectivity Bridge
tests:
  applications.connectivity_bridge:
    build_only: true
    platform_allow: protec3_nrf52840
    integration_platforms:
      - protec3_nrf52840
    tags: ci_build
```
